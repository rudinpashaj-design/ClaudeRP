/*@@author(-)*/
/*@@version(1.0)*/

/* ============================================================================
   CAN GATEWAY  CAN1 <-> CAN2  +  SIMULATORE ERRORI  (Vector CANalyzer 19)
   ============================================================================

   FUNZIONI
   --------
   1) Gateway trasparente bidirezionale: ogni frame ricevuto su CAN1 viene
      ritrasmesso su CAN2 e ogni frame ricevuto su CAN2 viene ritrasmesso su
      CAN1 (copia byte-per-byte, non serve avere i segnali nel DBC per
      inoltrare un frame: funziona per QUALSIASI ID).

   2) Simulazione errori, attivabile A RUNTIME (a misurazione avviata) tramite
      System Variables collegate ad un Panel:
        - TIMEOUT           : il frame indicato smette di essere inoltrato
                               (per una durata configurabile oppure a tempo
                               indeterminato finché non si preme "Clear")
        - DLC ERROR         : il frame indicato viene inoltrato con un DLC
                               forzato/errato
        - CHECKSUM ERROR    : il byte del segnale di checksum indicato viene
                               invalidato (incrementato di 1) prima di essere
                               inoltrato
        - COUNTER ERROR     : il segnale message-counter indicato viene
                               "congelato" (freeze, stesso valore ripetuto) o
                               fatto "saltare" (jump, +2) per rompere la
                               sequenza attesa dal ricevitore

   CONFIGURAZIONE FRAME / SEGNALI
   -------------------------------
   CAPL non può leggere in automatico dal DBC caricato la posizione bit di un
   segnale generico a runtime: la tabella frame/segnali in InitFrameTable()
   deve quindi essere precompilata. La tabella qui sotto è già stata generata
   dal DBC "CAN_HS1_AEE2010_R3_B2.2_K0_EURO6eBIS_V7.4.dbc" (52 frame: 23
   trasmessi dal nodo CMM su CAN1, 29 dagli altri nodi su CAN2), con byte
   index / bit start / bit length dei segnali CHKSUM_* e CPT_PROCESS_4B_*
   calcolati per encoding empirico direttamente dal DBC (vedi commenti dentro
   InitFrameTable() per le due esclusioni e la nota su COMPTEUR_RAZ_GCT).
   Se il DBC cambia, la tabella va rigenerata di conseguenza:
       AddFrame(nome, ID);
       AddSignal(ID, "NomeSegnale", byteIndex, bitStart, bitLen);

   NOMI RETE CAN1 / CAN2
   ----------------------
   Lo script assume che nella configurazione di CANalyzer le due reti si
   chiamino "CAN1" e "CAN2" (sintassi "on message CAN1::*"). Se nel proprio
   progetto i bus hanno un altro nome, sostituire i nomi nei due handler
   "on message", oppure usare la variante alternativa commentata più sotto
   basata su "this.can".

   INPUT UTENTE: SYSTEM VARIABLES DA CREARE
   ------------------------------------------
   Creare in CANalyzer (finestra "System Variables" -> tasto destro ->
   New Namespace "GatewaySim") le seguenti variabili:

     Nome                          Tipo     Descrizione
     ----------------------------  -------  --------------------------------
     FrameIdentifier                String   Nome frame (es. "EngineData")
                                             oppure ID (es. "0x100" o "256")
     ChecksumSignalName              String   Nome segnale checksum (solo per
                                             ErrorType = 2)
     CounterSignalName               String   Nome segnale counter (solo per
                                             ErrorType = 4 o 5)
     TimeoutDuration_ms               Integer  Durata timeout in ms
                                             (0 = indeterminato, fino a Clear)
     DlcErrorValue                    Integer  DLC errato da forzare (0..8)
     ErrorType                        Integer  0 = Nessuno
                                             1 = Timeout
                                             2 = Checksum error
                                             3 = DLC error
                                             4 = Counter error (freeze)
                                             5 = Counter error (jump)
     ApplyTrigger                     Integer  Incrementare/toggle da Panel
                                             per applicare la simulazione
     ClearTrigger                     Integer  Incrementare/toggle da Panel
                                             per disattivare tutte le
                                             simulazioni attive
     StatusText                       String   Testo di stato (sola lettura,
                                             scritto dallo script)

   PANEL (Panel Designer)
   ------------------------
   Creare un Panel con:
     - Edit box  -> FrameIdentifier
     - Edit box  -> ChecksumSignalName
     - Edit box  -> CounterSignalName
     - Edit box (numerico) -> TimeoutDuration_ms
     - Edit box (numerico) -> DlcErrorValue
     - Combo box -> ErrorType (voci: None=0, Timeout=1, Checksum=2, DLC=3,
       CounterFreeze=4, CounterJump=5)
     - Pulsante  -> incrementa ApplyTrigger
     - Pulsante  -> incrementa ClearTrigger
     - Label     -> StatusText (sola visualizzazione)
   ============================================================================ */

variables
{
  /* ---------------- TABELLA FRAME (da configurare) ------------------------ */
  const int kMaxFrames = 64;
  char  gFrameName[64][51];
  dword gFrameId[64];
  int   gFrameCount;

  /* ---------------- TABELLA SEGNALI checksum/counter (da configurare) ----- */
  const int kMaxSignals = 48;
  dword gSigFrameId[48];
  char  gSigName[48][51];
  byte  gSigByteIdx[48];   /* indice byte (0..7) del segnale nel frame       */
  byte  gSigBitStart[48];  /* bit iniziale del segnale dentro il byte (0..7) */
  byte  gSigBitLen[48];    /* lunghezza in bit del segnale                   */
  int   gSigCount;

  /* ---------------- STATO SIMULAZIONE: TIMEOUT ---------------------------- */
  dword   gTimeoutActive  = 0;
  long    gTimeoutFrameId = -1;
  msTimer gTimeoutTimer;

  /* ---------------- STATO SIMULAZIONE: DLC ERROR --------------------------- */
  dword gDlcErrActive  = 0;
  long  gDlcErrFrameId = -1;
  byte  gDlcErrValue   = 0;

  /* ---------------- STATO SIMULAZIONE: CHECKSUM ERROR ----------------------- */
  dword gChkErrActive  = 0;
  long  gChkErrFrameId = -1;
  int   gChkErrSigIdx  = -1;

  /* ---------------- STATO SIMULAZIONE: COUNTER ERROR ------------------------ */
  dword gCntErrActive   = 0;
  long  gCntErrFrameId  = -1;
  int   gCntErrSigIdx   = -1;
  dword gCntErrMode     = 0;  /* 0 = freeze, 1 = jump */
  dword gCntFrozenValue = 0;
  dword gCntFrozenValid = 0;
}


/* ============================================================================
   INIZIALIZZAZIONE
   ============================================================================ */

on preStart
{
  gFrameCount = 0;
  gSigCount   = 0;
  InitFrameTable();
  write("[Gateway] Inizializzato. Frame configurati: %d, Segnali configurati: %d",
        gFrameCount, gSigCount);
}

void InitFrameTable()
{
  /* ============================================================
     Tabella generata da: CAN_HS1_AEE2010_R3_B2.2_K0_EURO6eBIS_V7.4.dbc
     52 frame totali (23 trasmessi da CMM -> CAN1, 29 da altri nodi -> CAN2).
     Byte index / bit start / bit length dei segnali CHKSUM_* e CPT_PROCESS_4B_*
     calcolati per encoding empirico (bit-a-bit) direttamente dal DBC, quindi
     corretti indipendentemente dal byte order (Motorola) usato nel file.

     NOTE:
      - CPT_NBR_REDEM (CMM_1E8, 16 bit) e CPT_TEMPOREL (V2_BSI_552, 32 bit)
        NON sono stati aggiunti: sono contatori "gestionali" (n. riavvii /
        tempo trascorso), non rolling counter di frame su singolo byte, quindi
        non adatti alla simulazione errore counter frame-per-frame.
      - COMPTEUR_RAZ_GCT (V2_BSI_552) e' un contatore a 8 bit isolabile in un
        byte, ma dal nome sembra un contatore di reset/eventi GCT piuttosto
        che un vero rolling counter di frescatura frame: verificare se e'
        il segnale giusto prima di usarlo per simulare errori counter.
     ============================================================ */

  AddFrame("IMMO_CMM_BSI_072", 0x72);

  AddFrame("ELECTRON_BSI_092", 0x92);

  AddFrame("IMMO_BSI_CMM_0A8", 0xA8);

  AddFrame("IMMO_UCC_CMM_0E0", 0xE0);

  AddFrame("IMMO_CMM_UCC_0E8", 0xE8);

  AddFrame("VERS_CMM_108", 0x108);

  AddFrame("CMM_1E8", 0x1E8);
  /* CPT_NBR_REDEM (16 bit) non aggiunto: vedi nota sopra */

  AddFrame("CMM_208", 0x208);

  AddFrame("VOL_305", 0x305);
  AddSignal(0x305, "CHKSUM_VOL", 4, 4, 4);
  AddSignal(0x305, "CPT_PROCESS_4B_A_VOL", 4, 0, 4);

  AddFrame("FRE_30D", 0x30D);

  AddFrame("CMM_348", 0x348);

  AddFrame("V2_BVA_349", 0x349);
  AddSignal(0x349, "CHKSUM_TRME_DYN_V2_349", 6, 4, 4);
  AddSignal(0x349, "CPT_PROCESS_4B_V2_349", 6, 0, 4);

  AddFrame("CDS_V2_34D", 0x34D);
  AddSignal(0x34D, "CHKSUM_FRAME_4B_34D", 4, 0, 4);
  AddSignal(0x34D, "CPT_PROCESS_4B_ESP", 5, 0, 4);

  AddFrame("CMM_388", 0x388);

  AddFrame("ABR_38D", 0x38D);
  AddSignal(0x38D, "CPT_PROCESS_4B_38D", 5, 4, 4);
  AddSignal(0x38D, "CHKSUM_TRME_DYN_UC_FREIN", 5, 0, 4);

  AddFrame("SI_EASY_MOVE_3AD", 0x3AD);
  AddSignal(0x3AD, "CPT_PROCESS_4B_EASY_MOVE_ESP", 7, 4, 4);
  AddSignal(0x3AD, "CHKSUM_TRME_DYN_EASY_MOVE_ESP", 7, 0, 4);

  AddFrame("V2_BV_3C9", 0x3C9);
  AddSignal(0x3C9, "CHKSUM_TRME_DYN_V2_3C9", 3, 4, 4);
  AddSignal(0x3C9, "CPT_PROCESS_4B_V2_3C9", 3, 0, 4);

  AddFrame("FRE_3CD", 0x3CD);
  AddSignal(0x3CD, "CHKSUM_TRAME_4B_3CD", 7, 4, 4);
  AddSignal(0x3CD, "CPT_PROCESS_4B_3CD", 7, 0, 4);

  AddFrame("BSI_412", 0x412);

  AddFrame("BSI_432", 0x432);
  AddSignal(0x432, "CPT_PROCESS_4B_BSI_1", 1, 0, 4);

  AddFrame("ABR_44D", 0x44D);

  AddFrame("CMM_468", 0x468);

  AddFrame("V2_BV_489", 0x489);

  AddFrame("BDE_VIN_VDS_BSI_492", 0x492);

  AddFrame("DIRA_495", 0x495);
  AddSignal(0x495, "CHKSUM_TRAME_4B_495", 4, 4, 4);
  AddSignal(0x495, "CPT_PROCESS_4B_495", 4, 0, 4);

  AddFrame("CRASH_4C8", 0x4C8);

  AddFrame("BV_4E9", 0x4E9);
  AddSignal(0x4E9, "CPT_PROCESS_4B_4E9", 1, 4, 4);
  AddSignal(0x4E9, "CHKSUM_TRAME_4B_4E9", 1, 0, 4);

  AddFrame("CMM_4F8", 0x4F8);
  AddSignal(0x4F8, "CHKSUM_TRAME_4B_4F8", 2, 4, 4);
  AddSignal(0x4F8, "CPT_PROCESS_4B_4F8", 2, 0, 4);

  AddFrame("ABR_50D", 0x50D);
  AddSignal(0x50D, "CPT_PROCESS_4B_50D", 7, 4, 4);
  AddSignal(0x50D, "CHKSUM_TRME_DAT_UC_FREIN", 7, 0, 4);

  AddFrame("V2_BSI_552", 0x552);
  AddSignal(0x552, "COMPTEUR_RAZ_GCT", 7, 0, 8); /* vedi nota sopra */
  /* CPT_TEMPOREL (32 bit) non aggiunto: vedi nota sopra */

  AddFrame("NEW_JDD_55F", 0x55F);

  AddFrame("BSI_56E", 0x56E);
  AddSignal(0x56E, "CPT_PROCESS_4B_56E", 4, 4, 4);
  AddSignal(0x56E, "CHKSUM_FRAME_4B_56E", 4, 0, 4);

  AddFrame("BSI_572", 0x572);

  AddFrame("CMM_588", 0x588);

  AddFrame("CMM_598", 0x598);

  AddFrame("CONTEXTE_1_5B2", 0x5B2);

  AddFrame("CMM_5F8", 0x5F8);

  AddFrame("EOBD_CMM_608", 0x608);

  AddFrame("BSI_612", 0x612);

  AddFrame("REP_DIAG_ON_CAN_688", 0x688);

  AddFrame("REQ_DIAG_ON_CAN_6A8", 0x6A8);

  AddFrame("NEW_JDD_CMM_768", 0x768);

  AddFrame("SUPV_V2_CMM_788", 0x788);

  AddFrame("IS_MAP_CMM_7A8", 0x7A8);

  AddFrame("OUTIL_PRTCLE_CCP_7CC", 0x7CC);

  AddFrame("OUTIL_PRTCLE_CCP_7CD", 0x7CD);

  AddFrame("OUTIL_PRTCLE_CCP_7CE", 0x7CE);

  AddFrame("OUTIL_PRTCLE_CCP_7CF", 0x7CF);

  AddFrame("REQ_EOBD_ON_CAN_V2_7DF", 0x7DF);

  AddFrame("REQ_EOBD_ON_CAN_7E0", 0x7E0);

  AddFrame("REP_EOBD_ON_CAN_7E8", 0x7E8);

  AddFrame("UDS_ON_CAN_7FF", 0x7FF);
}

void AddFrame(char name[], dword id)
{
  if (gFrameCount >= kMaxFrames)
  {
    write("[Gateway] ATTENZIONE: tabella frame piena, aumentare kMaxFrames");
    return;
  }
  strncpy(gFrameName[gFrameCount], name, elcount(gFrameName[gFrameCount]));
  gFrameId[gFrameCount] = id;
  gFrameCount = gFrameCount + 1;
}

void AddSignal(dword frameId, char name[], byte byteIdx, byte bitStart, byte bitLen)
{
  if (gSigCount >= kMaxSignals)
  {
    write("[Gateway] ATTENZIONE: tabella segnali piena, aumentare kMaxSignals");
    return;
  }
  gSigFrameId[gSigCount] = frameId;
  strncpy(gSigName[gSigCount], name, elcount(gSigName[gSigCount]));
  gSigByteIdx[gSigCount]  = byteIdx;
  gSigBitStart[gSigCount] = bitStart;
  gSigBitLen[gSigCount]   = bitLen;
  gSigCount = gSigCount + 1;
}


/* ============================================================================
   GATEWAY CAN1 <-> CAN2
   ============================================================================
   NOTA: "this.dir == RX" e' fondamentale per evitare che il frame appena
   ritrasmesso da questo stesso programma venga letto di nuovo come se fosse
   in ingresso, generando un loop di inoltro CAN1->CAN2->CAN1->...
   ============================================================================ */

on message CAN1::*
{
  if (this.dir == RX)
  {
    ForwardFrame(this, 2);
  }
}

on message CAN2::*
{
  if (this.dir == RX)
  {
    ForwardFrame(this, 1);
  }
}

/* ALTERNATIVA, se le reti non si chiamano "CAN1"/"CAN2" nella propria
   configurazione: rimuovere i due handler sopra e usare questo, basato sul
   numero di canale fisico:

on message *
{
  if (this.dir == RX)
  {
    if (this.can == 1)      ForwardFrame(this, 2);
    else if (this.can == 2) ForwardFrame(this, 1);
  }
}
*/

void ForwardFrame(message inMsg, dword targetChannel)
{
  message txMsg;
  int   i;
  byte  cByte, cStart, cLen;
  byte  rawByte;
  dword curVal, newVal, maxVal;

  /* ---- 1) TIMEOUT: il frame selezionato non viene inoltrato ---- */
  if (gTimeoutActive == 1 && inMsg.id == gTimeoutFrameId)
  {
    return;
  }

  txMsg.id  = inMsg.id;
  txMsg.dlc = inMsg.dlc;
  txMsg.dir = TX;
  txMsg.can = targetChannel;

  for (i = 0; i < inMsg.dlc && i < 8; i = i + 1)
  {
    txMsg.byte(i) = inMsg.byte(i);
  }

  /* ---- 2) DLC ERROR: forza un DLC errato in uscita ---- */
  if (gDlcErrActive == 1 && inMsg.id == gDlcErrFrameId)
  {
    txMsg.dlc = gDlcErrValue;
  }

  /* ---- 3) CHECKSUM ERROR: invalida il byte del segnale di checksum ---- */
  if (gChkErrActive == 1 && inMsg.id == gChkErrFrameId && gChkErrSigIdx >= 0)
  {
    cByte = gSigByteIdx[gChkErrSigIdx];
    txMsg.byte(cByte) = (inMsg.byte(cByte) + 1) & 0xFF;
  }

  /* ---- 4) COUNTER ERROR: freeze o jump del message counter ---- */
  if (gCntErrActive == 1 && inMsg.id == gCntErrFrameId && gCntErrSigIdx >= 0)
  {
    cByte  = gSigByteIdx[gCntErrSigIdx];
    cStart = gSigBitStart[gCntErrSigIdx];
    cLen   = gSigBitLen[gCntErrSigIdx];
    maxVal = (1 << cLen) - 1;

    rawByte = inMsg.byte(cByte);
    curVal  = ReadBits(rawByte, cStart, cLen);

    if (gCntErrMode == 0)
    {
      /* freeze: congela il counter al primo valore osservato dopo l'attivazione */
      if (gCntFrozenValid == 0)
      {
        gCntFrozenValue = curVal;
        gCntFrozenValid = 1;
      }
      newVal = gCntFrozenValue;
    }
    else
    {
      /* jump: rompe la sequenza saltando 2 valori */
      newVal = (curVal + 2) & maxVal;
    }

    txMsg.byte(cByte) = WriteBits(txMsg.byte(cByte), cStart, cLen, newVal);
  }

  output(txMsg);
}

dword ReadBits(byte b, byte startBit, byte len)
{
  dword mask;
  mask = (1 << len) - 1;
  return (b >> startBit) & mask;
}

byte WriteBits(byte b, byte startBit, byte len, dword value)
{
  dword mask;
  mask = ((1 << len) - 1) << startBit;
  return (b & ~mask) | ((value << startBit) & mask);
}


/* ============================================================================
   RISOLUZIONE FRAME / SEGNALI da stringa utente
   ============================================================================ */

dword IsAllDigits(char s[])
{
  int i;
  if (strlen(s) == 0)
  {
    return 0;
  }
  i = 0;
  while (s[i] != 0)
  {
    if (s[i] < '0' || s[i] > '9')
    {
      return 0;
    }
    i = i + 1;
  }
  return 1;
}

dword IsNumericId(char ident[], long &idVal)
{
  long val;

  if (strlen(ident) > 1 && ident[0] == '0' && (ident[1] == 'x' || ident[1] == 'X'))
  {
    if (sscanf(ident, "0x%x", val) == 1)
    {
      idVal = val;
      return 1;
    }
    return 0;
  }

  if (IsAllDigits(ident) == 1)
  {
    sscanf(ident, "%d", val);
    idVal = val;
    return 1;
  }

  return 0;
}

int ResolveFrameIndex(char ident[])
{
  int  i;
  long idVal;

  if (IsNumericId(ident, idVal) == 1)
  {
    for (i = 0; i < gFrameCount; i = i + 1)
    {
      if (gFrameId[i] == idVal)
      {
        return i;
      }
    }
    return -1;
  }

  for (i = 0; i < gFrameCount; i = i + 1)
  {
    if (stricmp(gFrameName[i], ident) == 0)
    {
      return i;
    }
  }
  return -1;
}

int ResolveSignalIndex(dword frameId, char signalName[])
{
  int i;
  for (i = 0; i < gSigCount; i = i + 1)
  {
    if (gSigFrameId[i] == frameId && stricmp(gSigName[i], signalName) == 0)
    {
      return i;
    }
  }
  return -1;
}


/* ============================================================================
   INPUT UTENTE (System Variables) -> ATTIVAZIONE / DISATTIVAZIONE ERRORI
   ============================================================================ */

on sysvar_update sysvar::GatewaySim::ApplyTrigger
{
  char ident[51];
  char sigName[51];
  int  fIdx;
  int  sIdx;
  int  errType;
  long frameId;
  char buf[200];

  ident   = @sysvar::GatewaySim::FrameIdentifier;
  errType = @sysvar::GatewaySim::ErrorType;

  fIdx = ResolveFrameIndex(ident);
  if (fIdx < 0)
  {
    snprintf(buf, elcount(buf), "ERRORE: frame non trovato: %s", ident);
    @sysvar::GatewaySim::StatusText = buf;
    write("[Gateway] %s", buf);
    return;
  }
  frameId = gFrameId[fIdx];

  switch (errType)
  {
    case 1: /* Timeout */
      gTimeoutFrameId = frameId;
      gTimeoutActive  = 1;
      cancelTimer(gTimeoutTimer);
      if (@sysvar::GatewaySim::TimeoutDuration_ms > 0)
      {
        setTimer(gTimeoutTimer, @sysvar::GatewaySim::TimeoutDuration_ms);
      }
      snprintf(buf, elcount(buf), "Timeout ATTIVO su %s (ID 0x%X)", ident, frameId);
      break;

    case 2: /* Checksum error */
      sigName = @sysvar::GatewaySim::ChecksumSignalName;
      sIdx = ResolveSignalIndex(frameId, sigName);
      if (sIdx < 0)
      {
        snprintf(buf, elcount(buf), "ERRORE: segnale checksum non trovato: %s", sigName);
        @sysvar::GatewaySim::StatusText = buf;
        write("[Gateway] %s", buf);
        return;
      }
      gChkErrFrameId = frameId;
      gChkErrSigIdx  = sIdx;
      gChkErrActive  = 1;
      snprintf(buf, elcount(buf), "Errore CHECKSUM attivo su %s.%s", ident, sigName);
      break;

    case 3: /* DLC error */
      gDlcErrFrameId = frameId;
      gDlcErrValue   = (byte)@sysvar::GatewaySim::DlcErrorValue;
      gDlcErrActive  = 1;
      snprintf(buf, elcount(buf), "Errore DLC attivo su %s (DLC forzato a %d)", ident, gDlcErrValue);
      break;

    case 4: /* Counter error - freeze */
    case 5: /* Counter error - jump */
      sigName = @sysvar::GatewaySim::CounterSignalName;
      sIdx = ResolveSignalIndex(frameId, sigName);
      if (sIdx < 0)
      {
        snprintf(buf, elcount(buf), "ERRORE: segnale counter non trovato: %s", sigName);
        @sysvar::GatewaySim::StatusText = buf;
        write("[Gateway] %s", buf);
        return;
      }
      gCntErrFrameId  = frameId;
      gCntErrSigIdx   = sIdx;
      gCntErrMode     = errType - 4; /* 0 = freeze, 1 = jump */
      gCntFrozenValid = 0;
      gCntErrActive   = 1;
      if (gCntErrMode == 0)
      {
        snprintf(buf, elcount(buf), "Errore COUNTER (freeze) attivo su %s.%s", ident, sigName);
      }
      else
      {
        snprintf(buf, elcount(buf), "Errore COUNTER (jump) attivo su %s.%s", ident, sigName);
      }
      break;

    default: /* 0 = Nessuno */
      snprintf(buf, elcount(buf), "ErrorType = None, nessuna simulazione attivata");
      break;
  }

  @sysvar::GatewaySim::StatusText = buf;
  write("[Gateway] %s", buf);
}

on sysvar_update sysvar::GatewaySim::ClearTrigger
{
  gTimeoutActive  = 0;
  gTimeoutFrameId = -1;
  cancelTimer(gTimeoutTimer);

  gDlcErrActive  = 0;
  gDlcErrFrameId = -1;

  gChkErrActive  = 0;
  gChkErrFrameId = -1;
  gChkErrSigIdx  = -1;

  gCntErrActive   = 0;
  gCntErrFrameId  = -1;
  gCntErrSigIdx   = -1;
  gCntFrozenValid = 0;

  @sysvar::GatewaySim::StatusText = "Tutte le simulazioni di errore disattivate";
  write("[Gateway] Simulazioni errore azzerate.");
}

on timer gTimeoutTimer
{
  gTimeoutActive  = 0;
  gTimeoutFrameId = -1;
  @sysvar::GatewaySim::StatusText = "Timeout terminato, forwarding ripristinato";
  write("[Gateway] Timeout terminato, forwarding ripristinato.");
}
