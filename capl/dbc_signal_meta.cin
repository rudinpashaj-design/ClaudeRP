/*@@author(-)*/
/*@@version(1.0)*/
/* ============================================================================
   CATALOGO SEGNALI GENERATO AUTOMATICAMENTE DAL DBC
     c3a93587-P250MY26_C1CANCAN_R1_E1A_CR20190.dbc
   NON MODIFICARE A MANO: rigenerato dallo script gen.py.
   266 frame, 1580 segnali. Un indice (0..1579) identifica ogni segnale;
   lo stesso indice e' usato dalla System Variable enum 'GwManip::Signal'
   (vedi GatewayManip_SysVars.vsysvar) e dal file dbc_signal_index.md.
   Campi per indice:
     gMetaMsgId  : ID del frame (11/29 bit, senza flag extended)
     gMetaStart  : start bit del segnale (come da DBC)
     gMetaLen    : lunghezza in bit
     gMetaOrder  : 1 = Intel/little-endian, 0 = Motorola/big-endian
     gMetaSigned : 1 = signed, 0 = unsigned
     gMetaHasVT  : 1 = ha una value table (enum) nel DBC
     gMetaFactor / gMetaOffset : phys = raw*factor + offset
     gMetaMin / gMetaMax        : range fisico dichiarato nel DBC
   ============================================================================ */

variables
{
  const int gMetaCount = 1580;
  dword gMetaMsgId[1580] = {
  599, 599, 599, 599, 599, 599, 599, 599, 599, 599, 599, 599, 599, 599, 599, 599, 599, 599, 599, 599, 599, 
  599, 599, 599, 599, 599, 599, 1447, 1447, 1447, 597, 597, 1068, 1068, 1068, 1068, 511488001, 120, 120, 119, 
  119, 118, 118, 117, 117, 117, 117, 117, 117, 1050, 1050, 1050, 1050, 1050, 1050, 1050, 247, 247, 247, 247, 
  247, 250, 250, 250, 250, 250, 250, 250, 250, 250, 250, 250, 250, 250, 250, 250, 250, 250, 250, 250, 1994, 
  245, 1446, 1444, 1444, 1200, 1200, 748, 748, 1470, 161, 161, 900, 900, 900, 900, 900, 900, 900, 900, 900, 
  900, 900, 900, 900, 900, 900, 900, 900, 900, 900, 1349, 1349, 1349, 1349, 1349, 1349, 1349, 1349, 1349, 
  1349, 1349, 1201, 1201, 1201, 1201, 1201, 1201, 1201, 1201, 1201, 1201, 1201, 1201, 1201, 1201, 1201, 1201, 
  1201, 1201, 1201, 1049, 1049, 1049, 1049, 1049, 1049, 1049, 1049, 1049, 1049, 1049, 1049, 576, 576, 576, 
  577, 577, 497, 497, 497, 257, 257, 257, 257, 257, 257, 257, 257, 257, 257, 257, 257, 506, 506, 506, 259, 
  259, 259, 259, 259, 259, 259, 259, 501, 501, 501, 498, 498, 498, 498, 498, 498, 498, 1048, 1048, 1048, 1048, 
  1048, 1048, 1199, 1199, 1199, 1199, 1199, 1199, 1199, 1199, 1199, 1199, 1199, 1199, 1199, 1199, 1199, 1199, 
  1199, 1199, 1199, 1199, 1199, 1199, 1199, 1453, 1453, 1453, 1453, 1453, 1453, 1453, 254, 254, 254, 254, 254, 
  254, 254, 254, 254, 254, 1451, 1440, 1440, 1440, 1440, 1440, 1440, 1440, 1440, 1440, 1440, 1440, 1440, 1440, 
  1440, 1440, 1440, 1440, 504446976, 504446976, 504446976, 504446976, 504446976, 504446976, 504446976, 
  504446976, 504446976, 504446976, 504446976, 504447033, 504447033, 504447033, 504447033, 504447033, 
  504447033, 504447033, 504447033, 504447033, 504447033, 504447033, 504446977, 504446977, 504446977, 
  504446977, 504446977, 504446977, 504446977, 504446977, 504446977, 504446977, 504446977, 504447040, 
  504447040, 504447040, 504447040, 504447040, 504447040, 504447040, 504447040, 504447040, 504447040, 
  504447040, 504446979, 504446979, 504446979, 504446979, 504446979, 504446979, 504446979, 504446979, 
  504446979, 504446979, 504446979, 504447041, 504447041, 504447041, 504447041, 504447041, 504447041, 
  504447041, 504447041, 504447041, 504447041, 504447041, 504446998, 504446998, 504446998, 504446998, 
  504446998, 504446998, 504446998, 504446998, 504446998, 504446998, 504446998, 504447011, 504447011, 
  504447011, 504447011, 504447011, 504447011, 504447011, 504447011, 504447011, 504447011, 504447011, 
  504447008, 504447008, 504447008, 504447008, 504447008, 504447008, 504447008, 504447008, 504447008, 
  504447008, 504447008, 504446987, 504446987, 504446987, 504446987, 504446987, 504446987, 504446987, 
  504446987, 504446987, 504446987, 504446987, 1516, 1516, 1516, 1516, 1516, 1516, 1516, 1517, 1517, 1517, 
  1517, 1517, 1517, 1517, 601, 601, 601, 601, 601, 601, 601, 598, 598, 598, 598, 598, 598, 598, 598, 598, 598, 
  598, 224, 224, 224, 224, 224, 224, 557, 557, 557, 557, 557, 557, 1716, 1713, 1711, 1708, 1720, 1684, 1681, 
  1679, 1676, 1688, 417070833, 416959729, 416964593, 416956657, 416957681, 416950513, 416951025, 417001201, 
  416944369, 416952561, 416990449, 416957169, 417018865, 416952817, 416960753, 416964849, 416945393, 
  416989425, 416981233, 416950001, 416991217, 416992241, 416948209, 416978417, 416978161, 416976881, 
  416976625, 416990961, 416981489, 416946417, 417001804, 417001823, 417001792, 417001796, 417001770, 
  417001966, 417001744, 417001794, 417001808, 417001824, 417001748, 417001927, 417001931, 417001759, 
  417002024, 417002032, 417002180, 417002033, 417002176, 417002144, 417002022, 417002133, 417002132, 
  417002127, 417002126, 417001926, 417001889, 417001752, 1846, 1846, 1846, 1846, 1846, 1846, 1846, 1846, 
  511488000, 252, 252, 252, 252, 252, 252, 252, 252, 252, 252, 252, 252, 1445, 1445, 1445, 1445, 1445, 1445, 
  1445, 1202, 1202, 1202, 1350, 1350, 1350, 1350, 1053, 1053, 1053, 1053, 1847, 1847, 1051, 1051, 1051, 1492, 
  1492, 1492, 1492, 1492, 1492, 1492, 1492, 255, 255, 255, 255, 255, 255, 255, 255, 251, 251, 251, 251, 251, 
  251, 251, 496, 496, 496, 496, 496, 496, 496, 496, 749, 749, 749, 749, 751, 751, 751, 751, 751, 751, 751, 
  751, 550, 550, 550, 550, 550, 550, 550, 550, 550, 550, 550, 550, 550, 1854, 1854, 1854, 1854, 1854, 1854, 
  1854, 1854, 1854, 1854, 1075, 1075, 852, 852, 852, 852, 852, 852, 852, 222, 222, 222, 222, 222, 222, 222, 
  1896, 1896, 1896, 1896, 1896, 1896, 701, 701, 701, 701, 701, 701, 701, 701, 701, 701, 701, 1377, 1377, 1377, 
  1377, 1377, 1377, 1377, 1377, 1377, 1377, 1377, 1377, 1377, 1377, 1378, 1378, 1378, 1378, 1425, 1425, 1425, 
  1425, 1425, 1425, 1425, 1045, 1045, 1045, 1045, 1045, 1045, 654, 654, 654, 654, 654, 654, 654, 654, 654, 
  654, 654, 654, 654, 654, 654, 654, 654, 654, 654, 1518, 1518, 1518, 1518, 1518, 1518, 1519, 1519, 1519, 
  1519, 1519, 1519, 878, 878, 878, 878, 878, 878, 878, 878, 878, 878, 1598, 1598, 1598, 1598, 1598, 1076, 
  1076, 1076, 1076, 1076, 1076, 1076, 1465, 1465, 1465, 1465, 1465, 1465, 1465, 1465, 1466, 1466, 1466, 1466, 
  1466, 1466, 1466, 1840, 1840, 1840, 1840, 1840, 1840, 1840, 1840, 1840, 272, 272, 272, 272, 85233, 90097, 
  82161, 83185, 76529, 126705, 69873, 82673, 86257, 90353, 70897, 116721, 117745, 73713, 116465, 106993, 
  71921, 1520, 1520, 1520, 1520, 1520, 1520, 1520, 1521, 1521, 1521, 1521, 1521, 1521, 1521, 1457, 1457, 1457, 
  1457, 1457, 1457, 1457, 1457, 1458, 1458, 1458, 1458, 1458, 1458, 1458, 1458, 1430, 1430, 1430, 1904, 1904, 
  1904, 1904, 1904, 1904, 234, 234, 234, 234, 234, 242, 242, 242, 242, 1934, 1934, 1934, 1934, 1934, 1577, 
  1939, 1939, 100, 100, 100, 100, 100, 100, 100, 104, 104, 104, 104, 104, 104, 104, 346, 346, 346, 346, 346, 
  346, 346, 346, 346, 346, 346, 346, 346, 346, 346, 346, 346, 346, 346, 346, 219, 219, 219, 221, 1058, 1058, 
  1058, 1058, 1058, 1058, 1058, 1058, 1058, 1058, 1058, 1060, 1060, 1060, 1060, 1060, 1060, 1060, 1060, 1062, 
  1062, 1062, 1062, 113, 113, 113, 113, 113, 113, 113, 113, 113, 113, 113, 114, 114, 114, 114, 114, 114, 114, 
  114, 114, 114, 114, 256, 256, 256, 256, 256, 256, 256, 256, 256, 256, 256, 256, 244, 244, 244, 244, 244, 
  500, 500, 500, 500, 500, 500, 500, 500, 500, 1047, 1047, 1047, 1047, 1047, 1042, 1042, 1042, 1042, 1042, 
  1042, 1042, 1042, 1042, 1042, 1042, 1829, 1829, 1829, 1829, 1830, 1830, 1830, 1830, 1830, 121, 124, 1414, 
  1414, 1414, 1414, 1414, 1414, 1414, 1414, 1414, 1414, 1414, 1414, 1414, 1414, 1414, 1414, 1414, 1414, 1414, 
  1414, 1414, 1414, 1414, 1414, 1414, 1414, 1414, 1414, 1414, 1414, 1414, 1414, 1414, 1414, 1414, 1414, 1414, 
  1414, 1414, 1414, 1414, 1414, 1414, 1414, 1414, 1414, 1414, 1414, 1414, 1414, 1414, 1414, 1414, 1414, 1414, 
  1414, 1414, 1414, 1414, 1414, 1414, 1414, 1414, 1414, 1414, 1414, 1414, 1414, 1414, 1414, 1414, 1414, 1414, 
  1414, 1414, 1414, 1414, 1413, 1413, 1413, 1413, 1413, 1413, 1413, 1413, 1413, 1413, 1413, 1413, 1413, 1413, 
  1413, 1413, 1413, 1413, 1413, 1413, 1413, 1413, 1413, 1413, 1413, 1413, 1413, 1413, 1413, 1413, 1413, 1413, 
  1413, 1413, 1413, 1413, 1413, 1413, 1413, 1413, 1413, 1413, 1413, 1413, 1413, 1413, 1413, 1413, 1413, 1413, 
  1413, 1413, 1413, 1413, 1413, 1413, 1413, 1413, 1413, 1413, 1413, 1413, 1413, 1413, 1413, 1413, 1413, 1413, 
  1413, 1413, 1413, 1413, 1413, 1413, 1413, 1413, 1413, 1413, 1413, 1413, 1413, 1413, 1413, 1413, 1413, 1413, 
  1413, 1413, 1413, 1413, 1413, 1413, 1413, 1413, 1413, 1413, 1413, 1413, 1413, 1413, 1413, 1413, 1413, 1413, 
  1413, 1413, 1413, 1413, 1413, 1413, 1413, 1413, 1413, 1413, 1413, 1413, 1413, 1413, 1413, 1413, 1413, 1413, 
  1413, 1413, 1413, 1413, 1413, 1413, 1413, 1417, 1417, 1417, 1417, 1417, 1417, 1417, 1417, 1417, 1417, 1417, 
  1417, 1417, 1417, 1417, 1417, 1417, 1417, 1417, 1417, 1417, 1417, 1417, 1417, 1417, 1417, 1417, 1417, 1417, 
  1431, 1431, 122, 122, 122, 122, 1382, 1382, 1382, 1382, 1382, 1382, 1382, 1382, 1382, 1382, 1382, 1382, 
  1382, 1382, 1382, 1382, 1382, 1382, 1382, 1382, 1382, 1382, 1382, 1382, 1382, 1826, 1826, 1826, 1826, 1827, 
  1827, 1827, 1828, 1828, 589, 589, 753, 753, 753, 753, 753, 753, 495, 495, 495, 495, 495, 495, 495, 495, 495, 
  1848, 1848, 1848, 1848, 1848, 1848, 1848, 1848, 546, 546, 546, 400, 400, 400, 400, 400, 400, 400, 400, 400, 
  400, 400, 400, 400, 400, 762, 762, 762, 762, 762, 762, 762, 762, 762, 762, 762, 762, 762, 762, 1003, 1003, 
  1003, 1436, 1436, 1436, 506855481, 506855481, 506855481, 506855481, 506855486, 506855486, 506855486, 
  506855486, 506855425, 506855425, 506855425, 506855425, 506855488, 506855488, 506855488, 506855488, 
  506855427, 506855427, 506855427, 506855427, 506855489, 506855489, 506855489, 506855489, 506855446, 
  506855446, 506855446, 506855446, 506855459, 506855459, 506855459, 506855459, 506855456, 506855456, 
  506855456, 506855456, 506855435, 506855435, 506855435, 506855435, 1454, 1454, 1454, 1454, 1454, 1454, 1454, 
  1454, 1454, 1454, 1454, 1454, 1454, 1454, 1454, 1454, 1454, 1454, 1504, 1504, 1504, 1504, 1504, 1504, 1504, 
  1504, 1504, 1941, 1450, 1450, 1450, 1450, 1435, 1435, 1435, 1435, 1435, 1196, 1196, 1196, 1196, 1196, 1196, 
  1196, 1196, 1196, 1196, 1196, 1196, 1198, 1198, 1198, 1198, 896, 896, 896, 896, 896, 896, 896, 896, 896, 
  896, 896, 896, 896, 1992, 1992, 123, 123, 1475, 1475, 1475, 1475, 1475, 1475, 1475, 1475, 1473, 1473, 1473, 
  1473, 1473, 1473, 1473, 1473, 1850, 1850, 1850, 1850, 1850, 1850, 1850, 1850, 1850, 1850, 1850, 1850, 271, 
  271, 1000, 1000, 240, 240, 240, 240, 240, 240, 240, 240, 240, 240, 503, 503, 503, 503, 503, 503, 503, 503, 
  503, 503, 352, 352, 352, 352, 260, 260, 260, 260, 260, 260, 260, 260, 260, 1448, 1448, 1448, 1448, 1448, 
  1448, 1448, 1448, 1448, 1448, 1448, 1448, 1448, 1448, 1448, 1448, 1448, 1448, 1448, 1448, 1448, 1448, 1448, 
  344, 344, 344, 344, 344, 344, 344, 253, 253, 253, 253, 253, 253, 243, 243, 243, 243, 243, 243, 243, 243, 
  243, 1480, 1480, 1046, 1046, 506724352, 506724352, 506724352, 506724352, 506724352, 506724352, 506724352, 
  506724352, 506724352, 506724352, 506724352, 506724352, 506724352, 506724352, 506724352, 506724352, 
  506724352, 506724352, 506724352, 506724352, 506724352, 506724352, 506724352, 506724352, 506724352, 
  506724352, 506724352, 506724352, 506724352, 506724352, 506724352, 506724352, 506724352, 506724352, 
  506724352, 506724358, 506724358, 506724358, 506724358, 506724416, 506724416, 506724416, 506724416, 
  506724355, 506724355, 506724355, 506724355, 506724417, 506724417, 506724417, 506724417, 506724374, 
  506724374, 506724374, 506724374, 278, 278, 278, 278, 278, 278, 278, 278, 278, 278, 278, 278, 278, 278, 238, 
  238, 238, 238, 238, 238 
};
  byte gMetaStart[1580] = {
  7, 5, 0, 1, 14, 12, 9, 8, 22, 19, 20, 17, 31, 50, 61, 28, 25, 39, 36, 34, 47, 51, 63, 45, 42, 40, 53, 63, 7, 
  51, 11, 1, 63, 15, 1, 51, 7, 7, 39, 39, 7, 7, 39, 15, 7, 23, 31, 63, 47, 39, 43, 7, 51, 14, 31, 23, 7, 31, 
  15, 63, 62, 14, 13, 12, 11, 2, 10, 3, 41, 55, 63, 47, 34, 43, 38, 7, 33, 39, 24, 9, 7, 7, 43, 19, 43, 5, 58, 
  34, 21, 5, 13, 7, 0, 3, 14, 43, 47, 52, 9, 16, 26, 35, 45, 39, 30, 31, 57, 27, 29, 41, 42, 21, 7, 2, 13, 14, 
  50, 20, 28, 27, 39, 45, 5, 4, 7, 37, 3, 0, 10, 2, 14, 61, 56, 15, 19, 29, 12, 11, 13, 45, 22, 31, 63, 39, 
  35, 23, 27, 46, 33, 7, 51, 19, 25, 35, 19, 47, 13, 39, 7, 15, 43, 7, 53, 5, 24, 63, 6, 19, 51, 4, 1, 20, 44, 
  26, 63, 51, 43, 39, 63, 4, 51, 3, 1, 11, 4, 6, 23, 36, 53, 13, 12, 18, 63, 51, 7, 31, 21, 19, 3, 14, 7, 11, 
  26, 47, 6, 63, 4, 33, 2, 3, 15, 1, 0, 14, 51, 12, 13, 32, 20, 18, 16, 30, 28, 4, 0, 5, 6, 7, 2, 20, 63, 32, 
  11, 34, 7, 35, 51, 46, 31, 33, 5, 43, 42, 44, 23, 31, 40, 7, 48, 5, 3, 2, 60, 33, 15, 39, 55, 41, 47, 35, 
  39, 27, 31, 19, 23, 11, 15, 3, 7, 47, 35, 39, 27, 31, 19, 23, 11, 15, 3, 7, 47, 35, 39, 27, 31, 19, 23, 11, 
  15, 3, 7, 47, 35, 39, 27, 31, 19, 23, 11, 15, 3, 7, 47, 35, 39, 27, 31, 19, 23, 11, 15, 3, 7, 47, 35, 39, 
  27, 31, 19, 23, 11, 15, 3, 7, 47, 35, 39, 27, 31, 19, 23, 11, 15, 3, 7, 47, 35, 39, 27, 31, 19, 23, 11, 15, 
  3, 7, 47, 35, 39, 27, 31, 19, 23, 11, 15, 3, 7, 47, 35, 39, 27, 31, 19, 23, 11, 15, 3, 7, 29, 12, 7, 20, 27, 
  30, 31, 29, 12, 7, 20, 27, 30, 31, 47, 50, 49, 56, 41, 42, 23, 5, 16, 21, 43, 41, 46, 47, 35, 37, 23, 19, 8, 
  7, 10, 12, 14, 15, 6, 26, 14, 13, 30, 1, 7, 7, 7, 7, 7, 7, 7, 7, 7, 7, 7, 7, 7, 7, 7, 7, 7, 7, 7, 7, 7, 7, 
  7, 7, 7, 7, 7, 7, 7, 7, 7, 7, 7, 7, 7, 7, 7, 7, 7, 7, 7, 7, 7, 7, 7, 7, 7, 7, 7, 7, 7, 7, 7, 7, 7, 7, 7, 7, 
  7, 7, 7, 7, 7, 7, 7, 7, 7, 7, 1, 2, 3, 6, 15, 23, 31, 39, 7, 25, 63, 7, 9, 22, 20, 28, 38, 51, 36, 52, 27, 
  6, 49, 7, 21, 8, 22, 20, 7, 1, 2, 7, 0, 29, 46, 63, 51, 7, 15, 39, 21, 7, 14, 34, 7, 3, 4, 31, 53, 34, 1, 
  15, 63, 14, 0, 15, 3, 19, 51, 24, 34, 63, 15, 22, 26, 51, 32, 4, 12, 6, 7, 63, 51, 20, 5, 7, 15, 34, 14, 38, 
  7, 15, 14, 11, 19, 18, 3, 25, 54, 12, 56, 3, 35, 62, 47, 43, 36, 17, 19, 23, 2, 1, 0, 15, 13, 23, 22, 21, 
  20, 18, 23, 13, 31, 2, 3, 1, 19, 21, 6, 47, 39, 7, 23, 38, 19, 35, 31, 39, 47, 23, 55, 7, 29, 4, 31, 3, 15, 
  1, 18, 48, 13, 7, 55, 63, 55, 7, 47, 3, 51, 22, 20, 2, 39, 58, 21, 23, 59, 31, 23, 7, 21, 57, 58, 27, 32, 
  11, 19, 55, 7, 12, 11, 16, 31, 36, 47, 30, 39, 29, 8, 1, 2, 5, 18, 17, 9, 10, 11, 12, 13, 14, 0, 6, 16, 29, 
  12, 7, 20, 27, 30, 29, 12, 7, 20, 27, 30, 15, 44, 49, 45, 22, 46, 39, 47, 7, 43, 26, 7, 34, 12, 19, 13, 7, 
  12, 20, 24, 19, 25, 13, 31, 39, 42, 35, 7, 23, 11, 13, 31, 39, 35, 7, 23, 11, 20, 31, 3, 13, 8, 7, 27, 39, 
  34, 63, 4, 36, 51, 7, 7, 7, 7, 7, 7, 7, 7, 7, 7, 7, 7, 7, 7, 7, 7, 7, 29, 12, 7, 20, 27, 30, 31, 29, 12, 7, 
  20, 27, 30, 31, 13, 34, 31, 39, 7, 23, 11, 35, 13, 34, 31, 39, 7, 23, 11, 35, 7, 15, 47, 47, 46, 31, 39, 48, 
  7, 63, 51, 9, 10, 7, 63, 33, 7, 51, 39, 19, 7, 23, 1, 7, 5, 4, 7, 47, 55, 15, 23, 31, 39, 7, 31, 39, 47, 55, 
  15, 23, 31, 4, 3, 2, 1, 0, 15, 23, 14, 13, 12, 11, 10, 9, 8, 6, 7, 5, 20, 19, 31, 15, 7, 23, 7, 36, 50, 5, 
  35, 43, 30, 21, 29, 51, 6, 3, 7, 21, 6, 12, 5, 29, 4, 27, 43, 7, 11, 15, 7, 31, 15, 15, 15, 15, 15, 15, 15, 
  15, 15, 7, 31, 15, 15, 15, 15, 15, 15, 15, 15, 63, 7, 53, 47, 32, 6, 5, 10, 31, 51, 36, 33, 55, 63, 6, 51, 
  34, 47, 63, 18, 5, 6, 17, 8, 51, 7, 7, 15, 14, 36, 32, 31, 39, 13, 11, 9, 15, 38, 12, 10, 14, 7, 14, 4, 1, 
  7, 9, 7, 25, 47, 53, 7, 7, 3, 3, 11, 19, 27, 35, 51, 51, 51, 51, 51, 51, 51, 51, 51, 51, 3, 11, 19, 27, 35, 
  35, 3, 19, 19, 19, 19, 19, 7, 35, 35, 35, 35, 35, 51, 51, 51, 51, 51, 35, 35, 35, 35, 35, 35, 19, 62, 62, 
  62, 62, 62, 43, 43, 43, 43, 43, 27, 27, 27, 27, 27, 19, 19, 19, 19, 19, 3, 3, 3, 3, 3, 3, 3, 3, 3, 3, 3, 32, 
  32, 32, 32, 32, 32, 32, 32, 32, 32, 0, 7, 0, 0, 0, 0, 0, 48, 48, 48, 48, 48, 32, 32, 32, 32, 32, 32, 32, 32, 
  32, 32, 40, 40, 40, 40, 40, 48, 48, 48, 48, 48, 48, 48, 48, 48, 48, 40, 40, 40, 40, 40, 40, 40, 40, 40, 40, 
  0, 0, 0, 0, 0, 0, 0, 0, 0, 48, 0, 0, 0, 0, 0, 0, 0, 0, 0, 0, 0, 0, 0, 0, 0, 0, 0, 0, 0, 0, 0, 0, 0, 0, 0, 0, 
  0, 0, 0, 0, 0, 0, 0, 0, 0, 0, 0, 0, 0, 0, 48, 48, 48, 48, 48, 32, 32, 32, 32, 32, 40, 0, 0, 0, 0, 0, 0, 32, 
  32, 32, 32, 32, 51, 51, 35, 3, 35, 7, 3, 3, 51, 51, 51, 51, 51, 35, 35, 35, 35, 35, 51, 43, 3, 3, 35, 35, 
  35, 35, 35, 3, 3, 7, 39, 15, 23, 31, 7, 7, 15, 15, 15, 15, 15, 15, 23, 55, 15, 15, 15, 15, 15, 15, 15, 15, 
  15, 15, 15, 15, 15, 15, 15, 15, 39, 23, 42, 7, 7, 23, 39, 7, 39, 7, 23, 29, 33, 10, 30, 7, 11, 63, 7, 24, 
  16, 3, 51, 12, 35, 39, 6, 0, 14, 12, 10, 8, 2, 22, 16, 43, 20, 17, 63, 7, 22, 3, 51, 2, 1, 30, 0, 15, 11, 
  10, 9, 6, 15, 0, 5, 23, 2, 1, 7, 4, 24, 11, 3, 31, 14, 23, 7, 15, 6, 5, 7, 1, 4, 2, 0, 1, 4, 2, 0, 1, 4, 2, 
  0, 1, 4, 2, 0, 1, 4, 2, 0, 1, 4, 2, 0, 1, 4, 2, 0, 1, 4, 2, 0, 1, 4, 2, 0, 1, 4, 2, 0, 63, 33, 7, 34, 27, 
  36, 44, 37, 19, 41, 46, 39, 24, 25, 29, 30, 26, 45, 63, 27, 16, 31, 29, 22, 18, 28, 51, 7, 15, 14, 7, 3, 10, 
  31, 3, 15, 35, 38, 32, 25, 35, 53, 1, 21, 7, 11, 40, 42, 41, 8, 11, 1, 7, 28, 27, 30, 29, 1, 11, 15, 7, 21, 
  24, 31, 23, 55, 8, 9, 5, 7, 8, 26, 23, 35, 7, 15, 39, 16, 8, 26, 23, 35, 7, 15, 39, 16, 23, 19, 7, 3, 15, 
  11, 31, 27, 39, 35, 47, 43, 7, 9, 5, 7, 63, 7, 36, 31, 51, 10, 12, 55, 9, 41, 63, 7, 51, 4, 16, 26, 25, 20, 
  5, 24, 47, 35, 1, 17, 63, 7, 11, 38, 51, 22, 10, 37, 30, 45, 11, 7, 63, 26, 9, 8, 6, 51, 5, 20, 3, 4, 19, 
  18, 17, 29, 41, 28, 34, 12, 2, 46, 21, 31, 6, 7, 19, 5, 4, 25, 7, 15, 26, 31, 30, 15, 23, 31, 39, 47, 55, 
  63, 3, 7, 22, 28, 15, 1, 7, 40, 41, 34, 35, 36, 37, 38, 39, 24, 25, 26, 27, 42, 28, 29, 30, 31, 16, 17, 18, 
  19, 20, 21, 43, 22, 23, 44, 45, 46, 47, 32, 33, 15, 6, 15, 7, 6, 23, 15, 7, 6, 23, 15, 7, 6, 23, 15, 7, 6, 
  23, 15, 7, 6, 23, 63, 7, 39, 47, 23, 35, 45, 51, 15, 37, 46, 31, 33, 44, 63, 7, 29, 51, 10, 32 
};
  byte gMetaLen[1580] = {
  2, 2, 2, 1, 2, 3, 1, 2, 2, 2, 1, 2, 3, 1, 2, 1, 2, 1, 2, 1, 2, 1, 2, 1, 2, 1, 2, 8, 3, 4, 2, 2, 8, 1, 2, 4, 
  64, 32, 32, 32, 32, 32, 32, 8, 8, 8, 16, 8, 8, 12, 7, 9, 1, 7, 8, 8, 8, 32, 16, 1, 1, 1, 1, 1, 1, 1, 1, 1, 
  2, 3, 8, 1, 1, 2, 4, 4, 2, 1, 1, 2, 16, 1, 3, 2, 2, 1, 1, 3, 1, 3, 10, 10, 2, 3, 5, 1, 1, 11, 9, 1, 1, 2, 1, 
  2, 1, 1, 1, 1, 2, 1, 1, 1, 4, 3, 8, 1, 4, 8, 1, 4, 1, 8, 1, 1, 1, 1, 1, 1, 1, 2, 1, 5, 1, 1, 6, 1, 1, 1, 1, 
  3, 3, 4, 8, 4, 2, 4, 2, 5, 1, 8, 4, 4, 2, 4, 16, 16, 16, 32, 8, 12, 4, 1, 2, 1, 2, 8, 1, 10, 4, 1, 13, 1, 2, 
  2, 8, 4, 8, 2, 8, 1, 4, 2, 6, 6, 3, 2, 2, 15, 1, 1, 1, 3, 8, 4, 1, 8, 1, 4, 1, 8, 1, 1, 1, 2, 1, 8, 1, 1, 1, 
  1, 1, 1, 1, 1, 4, 1, 1, 1, 2, 2, 2, 2, 1, 1, 1, 1, 1, 1, 2, 2, 8, 1, 12, 1, 12, 1, 4, 8, 12, 1, 2, 1, 1, 1, 
  8, 8, 1, 1, 3, 1, 1, 1, 1, 2, 8, 6, 6, 1, 4, 4, 4, 4, 4, 4, 4, 4, 4, 4, 4, 4, 4, 4, 4, 4, 4, 4, 4, 4, 4, 4, 
  4, 4, 4, 4, 4, 4, 4, 4, 4, 4, 4, 4, 4, 4, 4, 4, 4, 4, 4, 4, 4, 4, 4, 4, 4, 4, 4, 4, 4, 4, 4, 4, 4, 4, 4, 4, 
  4, 4, 4, 4, 4, 4, 4, 4, 4, 4, 4, 4, 4, 4, 4, 4, 4, 4, 4, 4, 4, 4, 4, 4, 4, 4, 4, 4, 4, 4, 4, 4, 4, 4, 4, 4, 
  4, 4, 4, 4, 4, 4, 4, 4, 4, 4, 4, 4, 4, 4, 4, 4, 2, 5, 8, 5, 4, 1, 1, 2, 5, 8, 5, 4, 1, 1, 2, 1, 9, 1, 3, 1, 
  20, 2, 1, 2, 2, 2, 3, 1, 1, 2, 2, 1, 1, 8, 1, 1, 2, 1, 1, 1, 1, 1, 2, 2, 64, 64, 64, 64, 64, 64, 64, 64, 64, 
  64, 64, 64, 64, 64, 64, 64, 64, 64, 64, 64, 64, 64, 64, 64, 64, 64, 64, 64, 64, 64, 64, 64, 64, 64, 64, 64, 
  64, 64, 64, 64, 64, 64, 64, 64, 64, 64, 64, 64, 64, 64, 64, 64, 64, 64, 64, 64, 64, 64, 64, 64, 64, 64, 64, 
  64, 64, 64, 64, 64, 1, 1, 1, 1, 8, 8, 8, 8, 64, 1, 8, 14, 1, 2, 8, 1, 1, 4, 2, 1, 2, 13, 8, 1, 1, 1, 1, 3, 
  5, 1, 1, 7, 12, 12, 5, 8, 4, 8, 1, 32, 13, 9, 1, 8, 3, 1, 1, 13, 13, 13, 1, 16, 8, 11, 1, 1, 1, 11, 4, 11, 
  1, 8, 9, 11, 8, 4, 1, 8, 8, 1, 1, 8, 4, 1, 1, 8, 1, 16, 2, 4, 4, 1, 3, 4, 1, 1, 4, 2, 5, 4, 1, 1, 4, 4, 4, 
  4, 1, 1, 2, 4, 1, 1, 1, 1, 1, 1, 1, 1, 1, 1, 8, 1, 8, 1, 1, 1, 4, 2, 3, 8, 1, 16, 1, 2, 12, 4, 8, 8, 8, 8, 
  16, 16, 2, 1, 2, 2, 1, 2, 1, 9, 3, 3, 3, 4, 4, 4, 3, 1, 4, 1, 13, 11, 8, 3, 1, 1, 1, 8, 1, 8, 1, 1, 1, 11, 
  1, 8, 8, 13, 11, 1, 11, 1, 11, 1, 8, 1, 8, 1, 1, 1, 1, 1, 1, 1, 1, 1, 1, 1, 1, 1, 1, 1, 1, 2, 5, 8, 5, 4, 1, 
  2, 5, 8, 5, 4, 1, 8, 1, 10, 1, 7, 1, 8, 1, 8, 1, 8, 11, 11, 9, 9, 1, 10, 8, 1, 1, 10, 1, 1, 5, 4, 7, 1, 8, 
  5, 4, 1, 5, 4, 1, 8, 5, 4, 5, 4, 4, 5, 4, 4, 4, 5, 4, 8, 13, 13, 4, 64, 64, 64, 64, 64, 64, 64, 64, 64, 64, 
  64, 64, 64, 64, 64, 64, 64, 2, 5, 8, 5, 4, 1, 1, 2, 5, 8, 5, 4, 1, 1, 1, 1, 5, 4, 8, 5, 4, 1, 1, 1, 5, 4, 8, 
  5, 4, 1, 8, 16, 24, 1, 7, 8, 8, 7, 16, 8, 4, 1, 1, 13, 8, 14, 13, 4, 10, 12, 6, 4, 10, 16, 1, 1, 8, 8, 8, 8, 
  8, 8, 8, 8, 8, 8, 8, 8, 8, 8, 8, 1, 1, 1, 1, 1, 1, 1, 1, 1, 1, 1, 1, 1, 1, 1, 1, 1, 1, 4, 16, 16, 8, 16, 1, 
  1, 1, 16, 8, 8, 1, 7, 9, 1, 1, 7, 1, 8, 1, 7, 1, 8, 1, 16, 16, 12, 16, 16, 8, 40, 56, 56, 56, 56, 56, 56, 
  56, 16, 16, 8, 40, 56, 56, 56, 56, 56, 56, 56, 16, 8, 1, 2, 1, 1, 1, 11, 11, 11, 4, 3, 1, 4, 8, 12, 4, 11, 
  4, 8, 1, 13, 1, 4, 4, 4, 1, 8, 1, 8, 1, 8, 8, 1, 1, 1, 10, 1, 1, 1, 1, 1, 8, 8, 3, 3, 3, 16, 14, 10, 10, 10, 
  32, 32, 16, 8, 8, 8, 8, 8, 8, 8, 8, 8, 8, 8, 8, 8, 8, 8, 8, 8, 8, 8, 8, 16, 32, 8, 8, 8, 8, 8, 4, 8, 8, 8, 
  8, 8, 5, 5, 5, 5, 5, 16, 16, 16, 16, 16, 16, 16, 3, 3, 3, 3, 3, 8, 8, 8, 8, 8, 8, 8, 8, 8, 8, 16, 16, 16, 
  16, 16, 16, 16, 16, 16, 16, 16, 16, 16, 16, 16, 32, 16, 16, 16, 16, 16, 16, 16, 16, 16, 16, 32, 7, 32, 32, 
  32, 32, 32, 8, 8, 8, 8, 8, 8, 8, 8, 8, 8, 8, 8, 8, 8, 8, 8, 8, 8, 8, 8, 8, 8, 8, 8, 8, 8, 8, 8, 8, 8, 8, 8, 
  8, 8, 8, 8, 8, 8, 8, 8, 32, 32, 32, 32, 32, 32, 32, 32, 32, 8, 32, 32, 32, 32, 32, 32, 32, 32, 32, 32, 32, 
  32, 32, 32, 32, 32, 32, 32, 32, 32, 32, 32, 32, 32, 32, 32, 32, 32, 32, 32, 32, 32, 32, 32, 32, 32, 32, 32, 
  32, 32, 8, 8, 8, 8, 8, 8, 8, 8, 8, 8, 16, 32, 32, 32, 32, 32, 32, 8, 8, 8, 8, 8, 8, 8, 8, 32, 16, 4, 32, 32, 
  8, 8, 8, 8, 8, 16, 16, 16, 16, 16, 8, 8, 32, 32, 16, 16, 16, 16, 16, 32, 32, 32, 32, 8, 8, 8, 8, 8, 32, 32, 
  32, 32, 32, 8, 32, 16, 32, 32, 32, 32, 32, 32, 32, 32, 32, 32, 32, 32, 32, 32, 32, 32, 13, 16, 1, 16, 16, 
  16, 16, 32, 32, 1, 20, 12, 1, 12, 1, 12, 1, 8, 2, 1, 8, 3, 4, 4, 8, 4, 4, 2, 2, 2, 2, 2, 2, 1, 1, 8, 4, 2, 
  8, 4, 2, 1, 4, 1, 1, 1, 1, 4, 1, 1, 3, 1, 1, 1, 1, 8, 1, 1, 1, 1, 1, 4, 1, 1, 1, 1, 8, 8, 1, 1, 1, 1, 2, 1, 
  1, 1, 2, 1, 1, 1, 2, 1, 1, 1, 2, 1, 1, 1, 2, 1, 1, 1, 2, 1, 1, 1, 2, 1, 1, 1, 2, 1, 1, 1, 2, 1, 1, 1, 2, 1, 
  1, 3, 2, 16, 1, 1, 2, 3, 1, 2, 8, 1, 1, 1, 1, 2, 1, 1, 1, 8, 5, 1, 1, 1, 4, 2, 1, 4, 2, 1, 1, 4, 4, 3, 3, 4, 
  3, 1, 3, 3, 3, 3, 2, 6, 6, 6, 6, 1, 1, 1, 3, 3, 6, 6, 1, 1, 1, 1, 2, 4, 4, 6, 6, 1, 1, 2, 2, 2, 1, 1, 1, 1, 
  1, 5, 4, 8, 5, 4, 1, 1, 1, 5, 4, 8, 5, 4, 1, 4, 4, 4, 4, 4, 4, 4, 4, 4, 4, 4, 4, 14, 14, 2, 2, 8, 11, 11, 
  11, 4, 1, 2, 1, 2, 2, 8, 2, 4, 16, 6, 1, 1, 1, 1, 16, 8, 4, 10, 10, 8, 12, 1, 1, 4, 8, 2, 4, 8, 3, 2, 1, 8, 
  4, 1, 4, 1, 4, 1, 1, 1, 1, 1, 1, 4, 1, 1, 1, 4, 1, 6, 1, 2, 8, 1, 1, 4, 1, 1, 2, 8, 16, 1, 1, 4, 8, 8, 8, 8, 
  8, 8, 8, 4, 4, 10, 6, 56, 2, 1, 1, 1, 1, 1, 1, 1, 1, 1, 1, 1, 1, 1, 1, 1, 1, 1, 1, 1, 1, 1, 1, 1, 1, 1, 1, 
  1, 1, 1, 1, 1, 1, 1, 8, 7, 8, 1, 7, 8, 8, 1, 7, 8, 8, 1, 7, 8, 8, 1, 7, 8, 8, 1, 7, 8, 8, 8, 2, 1, 8, 2, 1, 
  4, 8, 2, 1, 8, 2, 1, 8, 13, 13, 4, 13, 13 
};
  byte gMetaOrder[1580] = {
  0, 0, 0, 0, 0, 0, 0, 0, 0, 0, 0, 0, 0, 0, 0, 0, 0, 0, 0, 0, 0, 0, 0, 0, 0, 0, 0, 0, 0, 0, 0, 0, 0, 0, 0, 0, 
  0, 0, 0, 0, 0, 0, 0, 0, 0, 0, 0, 0, 0, 0, 0, 0, 0, 0, 0, 0, 0, 0, 0, 0, 0, 0, 0, 0, 0, 0, 0, 0, 0, 0, 0, 0, 
  0, 0, 0, 0, 0, 0, 0, 0, 0, 0, 0, 0, 0, 0, 0, 0, 0, 0, 0, 0, 0, 0, 0, 0, 0, 0, 0, 0, 0, 0, 0, 0, 0, 0, 0, 0, 
  0, 0, 0, 0, 0, 0, 0, 0, 0, 0, 0, 0, 0, 0, 0, 0, 0, 0, 0, 0, 0, 0, 0, 0, 0, 0, 0, 0, 0, 0, 0, 0, 0, 0, 0, 0, 
  0, 0, 0, 0, 0, 0, 0, 0, 0, 0, 0, 0, 0, 0, 0, 0, 0, 0, 0, 0, 0, 0, 0, 0, 0, 0, 0, 0, 0, 0, 0, 0, 0, 0, 0, 0, 
  0, 0, 0, 0, 0, 0, 0, 0, 0, 0, 0, 0, 0, 0, 0, 0, 0, 0, 0, 0, 0, 0, 0, 0, 0, 0, 0, 0, 0, 0, 0, 0, 0, 0, 0, 0, 
  0, 0, 0, 0, 0, 0, 0, 0, 0, 0, 0, 0, 0, 0, 0, 0, 0, 0, 0, 0, 0, 0, 0, 0, 0, 0, 0, 0, 0, 0, 0, 0, 0, 0, 0, 0, 
  0, 0, 0, 0, 0, 0, 0, 0, 0, 0, 0, 0, 0, 0, 0, 0, 0, 0, 0, 0, 0, 0, 0, 0, 0, 0, 0, 0, 0, 0, 0, 0, 0, 0, 0, 0, 
  0, 0, 0, 0, 0, 0, 0, 0, 0, 0, 0, 0, 0, 0, 0, 0, 0, 0, 0, 0, 0, 0, 0, 0, 0, 0, 0, 0, 0, 0, 0, 0, 0, 0, 0, 0, 
  0, 0, 0, 0, 0, 0, 0, 0, 0, 0, 0, 0, 0, 0, 0, 0, 0, 0, 0, 0, 0, 0, 0, 0, 0, 0, 0, 0, 0, 0, 0, 0, 0, 0, 0, 0, 
  0, 0, 0, 0, 0, 0, 0, 0, 0, 0, 0, 0, 0, 0, 0, 0, 0, 0, 0, 0, 0, 0, 0, 0, 0, 0, 0, 0, 0, 0, 0, 0, 0, 0, 0, 0, 
  0, 0, 0, 0, 0, 0, 0, 0, 0, 0, 0, 0, 0, 0, 0, 0, 0, 0, 0, 0, 0, 0, 0, 0, 0, 0, 0, 0, 0, 0, 0, 0, 0, 0, 0, 0, 
  0, 0, 0, 0, 0, 0, 0, 0, 0, 0, 0, 0, 0, 0, 0, 0, 0, 0, 0, 0, 0, 0, 0, 0, 0, 0, 0, 0, 0, 0, 0, 0, 0, 0, 0, 0, 
  0, 0, 0, 0, 0, 0, 0, 0, 0, 0, 0, 0, 0, 0, 0, 0, 0, 0, 0, 0, 0, 0, 0, 0, 0, 0, 0, 0, 0, 0, 0, 0, 0, 0, 0, 0, 
  0, 0, 0, 0, 0, 0, 0, 0, 0, 0, 0, 0, 0, 0, 0, 0, 0, 0, 0, 0, 0, 0, 0, 0, 0, 0, 0, 0, 0, 0, 0, 0, 0, 0, 0, 0, 
  0, 0, 0, 0, 0, 0, 0, 0, 0, 0, 0, 0, 0, 0, 0, 0, 0, 0, 0, 0, 0, 0, 0, 0, 0, 0, 0, 0, 0, 0, 0, 0, 0, 0, 0, 0, 
  0, 0, 0, 0, 0, 0, 0, 0, 0, 0, 0, 0, 0, 0, 0, 0, 0, 0, 0, 1, 0, 0, 0, 0, 0, 0, 0, 0, 0, 0, 0, 0, 0, 0, 0, 0, 
  0, 0, 0, 0, 0, 0, 0, 0, 0, 0, 0, 0, 0, 0, 0, 0, 0, 0, 0, 0, 0, 0, 0, 0, 0, 0, 0, 0, 0, 0, 0, 0, 0, 0, 0, 0, 
  0, 0, 0, 0, 0, 0, 0, 0, 0, 0, 0, 0, 0, 0, 0, 0, 0, 0, 0, 0, 0, 0, 0, 0, 0, 0, 0, 0, 0, 0, 0, 0, 0, 0, 0, 0, 
  0, 0, 0, 0, 0, 0, 0, 0, 0, 0, 0, 0, 0, 0, 0, 0, 0, 0, 0, 0, 0, 0, 0, 0, 0, 0, 0, 0, 0, 0, 0, 0, 0, 0, 0, 0, 
  0, 0, 0, 0, 0, 0, 0, 0, 0, 0, 0, 0, 0, 0, 0, 0, 0, 0, 0, 0, 0, 0, 0, 0, 0, 0, 0, 0, 0, 0, 0, 0, 0, 0, 0, 0, 
  0, 0, 0, 0, 0, 0, 0, 0, 0, 0, 0, 0, 0, 0, 0, 0, 0, 0, 0, 0, 0, 0, 0, 0, 0, 0, 0, 0, 0, 0, 0, 0, 0, 0, 0, 0, 
  0, 0, 0, 0, 0, 0, 0, 0, 0, 0, 0, 0, 0, 0, 0, 0, 0, 0, 0, 0, 0, 0, 0, 0, 0, 0, 0, 0, 0, 0, 0, 0, 0, 0, 0, 0, 
  0, 0, 0, 0, 0, 0, 0, 0, 0, 0, 0, 0, 0, 0, 0, 0, 0, 0, 0, 0, 0, 0, 0, 0, 0, 0, 0, 0, 0, 0, 0, 0, 0, 0, 0, 0, 
  0, 0, 0, 0, 0, 0, 0, 0, 0, 0, 0, 0, 0, 0, 0, 0, 0, 0, 0, 0, 0, 0, 0, 0, 0, 0, 0, 0, 0, 0, 0, 0, 0, 0, 0, 0, 
  0, 0, 0, 0, 0, 0, 0, 0, 0, 0, 0, 0, 0, 0, 0, 0, 0, 0, 0, 0, 0, 0, 0, 0, 0, 0, 0, 0, 0, 0, 0, 0, 0, 0, 0, 0, 
  0, 0, 0, 0, 0, 0, 0, 0, 0, 0, 0, 0, 0, 0, 0, 0, 0, 0, 0, 0, 0, 0, 0, 0, 0, 0, 0, 0, 0, 0, 0, 0, 0, 0, 0, 0, 
  0, 0, 0, 0, 0, 0, 0, 0, 0, 0, 0, 0, 0, 0, 0, 0, 0, 0, 0, 0, 0, 0, 0, 0, 0, 0, 0, 0, 0, 0, 0, 0, 0, 0, 0, 0, 
  0, 0, 0, 0, 0, 0, 0, 0, 0, 0, 0, 0, 0, 0, 0, 0, 0, 0, 0, 0, 0, 0, 0, 0, 0, 0, 0, 0, 0, 0, 0, 0, 0, 0, 0, 0, 
  0, 0, 0, 0, 0, 0, 0, 0, 0, 0, 0, 0, 0, 0, 0, 0, 0, 0, 0, 0, 0, 0, 0, 0, 0, 0, 0, 0, 0, 0, 0, 0, 0, 0, 0, 0, 
  0, 0, 0, 0, 0, 0, 0, 0, 0, 0, 0, 0, 0, 0, 0, 0, 0, 0, 0, 0, 0, 0, 0, 0, 0, 0, 0, 0, 0, 0, 0, 0, 0, 0, 0, 0, 
  0, 0, 0, 0, 0, 0, 0, 0, 0, 0, 0, 0, 0, 0, 0, 0, 0, 0, 0, 0, 0, 0, 0, 0, 0, 0, 0, 0, 0, 0, 0, 0, 0, 0, 0, 0, 
  0, 0, 0, 0, 0, 0, 0, 0, 0, 0, 0, 0, 0, 0, 0, 0, 0, 0, 0, 0, 0, 0, 0, 0, 0, 0, 0, 0, 0, 0, 0, 0, 0, 0, 0, 0, 
  0, 0, 0, 0, 0, 0, 0, 0, 0, 0, 0, 0, 0, 0, 0, 0, 0, 0, 0, 0, 0, 0, 0, 0, 0, 0, 0, 0, 0, 0, 0, 0, 0, 0, 0, 0, 
  0, 0, 0, 0, 0, 0, 0, 0, 0, 0, 0, 0, 0, 0, 0, 0, 0, 0, 0, 0, 0, 0, 0, 0, 0, 0, 0, 0, 0, 0, 0, 0, 0, 0, 0, 0, 
  0, 0, 0, 0, 0, 0, 0, 0, 0, 0, 0, 0, 0, 0, 0, 0, 0, 0, 0, 0, 0, 0, 0, 0, 0, 0, 0, 0, 0, 0, 0, 0, 0, 0, 0, 0, 
  0, 0, 0, 0, 0, 0, 0, 0, 0, 0, 0, 0, 0, 0, 0, 0, 0, 0, 0, 0, 0, 0, 0, 0, 0, 0, 0, 0, 0, 0, 0, 0, 0, 0, 0, 0, 
  0, 0, 0, 0, 0, 0, 0, 0, 0, 0, 0, 0, 0, 0, 0, 0, 0, 0, 0, 0, 0, 0, 0, 0, 0, 0, 0, 0, 0, 0, 0, 0, 0, 0, 0, 0, 
  0, 0, 0, 0, 0, 0, 0, 0, 0, 0, 0, 0, 0, 0, 0, 0, 0, 0, 0, 0, 0, 0, 0, 0, 0, 0, 0, 0, 0, 0, 0, 0, 0, 0, 0, 0, 
  0, 0, 0, 0, 0, 0, 0, 0, 0, 0, 0, 0, 0, 0, 0, 0, 0, 0, 0, 0, 0, 0, 0, 0, 0, 0, 0, 0, 0, 0, 0, 0, 0, 0, 0, 0, 
  0, 0, 0, 0, 0, 0, 0, 0, 0, 0, 0, 0, 0, 0, 0, 0, 0, 0, 0, 0, 0, 0, 0, 0, 0, 0, 0, 0, 0, 0, 0, 0, 0, 0, 0, 0, 
  0, 0, 0, 0, 0, 0, 0, 0, 0, 0, 0, 0, 0, 0, 0, 0, 0, 0, 0, 0, 0, 0, 0, 0, 0, 0, 0, 0, 0, 0, 0, 0, 0, 0, 0, 0, 
  0, 0, 0, 0, 0, 0, 0, 0, 0, 0, 0, 0, 0, 0, 0, 0, 0, 0, 0, 0, 0, 0, 0, 0, 0, 0, 0, 0, 0, 0, 0, 0, 0, 0, 0, 0, 
  0, 0, 0, 0, 0, 0, 0, 0, 0, 0, 0, 0, 0, 0, 0, 0, 0, 0, 0, 0, 0, 0, 0, 0, 0, 0, 0, 0, 0, 0, 0, 0 
};
  byte gMetaSigned[1580] = {
  0, 0, 0, 0, 0, 0, 0, 0, 0, 0, 0, 0, 0, 0, 0, 0, 0, 0, 0, 0, 0, 0, 0, 0, 0, 0, 0, 0, 0, 0, 0, 0, 0, 0, 0, 0, 
  0, 0, 0, 0, 0, 0, 0, 0, 0, 0, 0, 0, 0, 0, 0, 0, 0, 0, 0, 0, 0, 0, 0, 0, 0, 0, 0, 0, 0, 0, 0, 0, 0, 0, 0, 0, 
  0, 0, 0, 0, 0, 0, 0, 0, 0, 0, 0, 0, 0, 0, 0, 0, 0, 0, 0, 0, 0, 0, 0, 0, 0, 0, 0, 0, 0, 0, 0, 0, 0, 0, 0, 0, 
  0, 0, 0, 0, 0, 0, 0, 0, 0, 0, 0, 0, 0, 0, 0, 0, 0, 0, 0, 0, 0, 0, 0, 0, 0, 0, 0, 0, 0, 0, 0, 0, 0, 0, 0, 0, 
  0, 0, 0, 0, 0, 0, 0, 0, 0, 0, 0, 0, 0, 0, 0, 0, 0, 0, 0, 0, 0, 0, 0, 0, 0, 0, 0, 0, 0, 0, 0, 0, 0, 0, 0, 0, 
  0, 0, 0, 0, 0, 0, 0, 0, 0, 0, 0, 0, 0, 0, 0, 0, 0, 0, 0, 0, 0, 0, 0, 0, 0, 0, 0, 0, 0, 0, 0, 0, 0, 0, 0, 0, 
  0, 0, 0, 0, 0, 0, 0, 0, 0, 0, 0, 0, 0, 0, 0, 0, 0, 0, 0, 0, 0, 0, 0, 0, 0, 0, 0, 0, 0, 0, 0, 0, 0, 0, 0, 0, 
  0, 0, 0, 0, 0, 0, 0, 0, 0, 0, 0, 0, 0, 0, 0, 0, 0, 0, 0, 0, 0, 0, 0, 0, 0, 0, 0, 0, 0, 0, 0, 0, 0, 0, 0, 0, 
  0, 0, 0, 0, 0, 0, 0, 0, 0, 0, 0, 0, 0, 0, 0, 0, 0, 0, 0, 0, 0, 0, 0, 0, 0, 0, 0, 0, 0, 0, 0, 0, 0, 0, 0, 0, 
  0, 0, 0, 0, 0, 0, 0, 0, 0, 0, 0, 0, 0, 0, 0, 0, 0, 0, 0, 0, 0, 0, 0, 0, 0, 0, 0, 0, 0, 0, 0, 0, 0, 0, 0, 0, 
  0, 0, 0, 0, 0, 0, 0, 0, 0, 0, 0, 0, 0, 0, 0, 0, 0, 0, 0, 0, 0, 0, 0, 0, 0, 0, 0, 0, 0, 0, 0, 0, 0, 0, 0, 0, 
  0, 0, 0, 0, 0, 0, 0, 0, 0, 0, 0, 0, 0, 0, 0, 0, 0, 0, 0, 0, 0, 0, 0, 0, 0, 0, 0, 0, 0, 0, 0, 0, 0, 0, 0, 0, 
  0, 0, 0, 0, 0, 0, 0, 0, 0, 0, 0, 0, 0, 0, 0, 0, 0, 0, 0, 0, 0, 0, 0, 0, 0, 0, 0, 0, 0, 0, 0, 0, 0, 0, 0, 0, 
  0, 0, 0, 0, 0, 0, 0, 0, 0, 0, 0, 0, 0, 0, 0, 0, 0, 0, 0, 0, 0, 0, 0, 0, 0, 0, 0, 0, 0, 0, 0, 0, 0, 0, 0, 0, 
  0, 0, 0, 0, 0, 0, 0, 0, 0, 0, 0, 0, 0, 0, 0, 0, 0, 0, 0, 0, 0, 0, 0, 0, 0, 0, 0, 0, 0, 0, 0, 0, 0, 0, 0, 0, 
  0, 0, 0, 0, 0, 0, 0, 0, 0, 0, 0, 0, 0, 0, 0, 0, 0, 0, 0, 0, 0, 0, 0, 0, 0, 0, 0, 0, 0, 0, 0, 0, 0, 0, 0, 0, 
  0, 0, 0, 0, 0, 0, 0, 0, 0, 0, 0, 0, 0, 0, 0, 0, 0, 0, 0, 0, 0, 0, 0, 0, 0, 0, 0, 0, 0, 0, 0, 0, 0, 0, 0, 0, 
  0, 0, 0, 0, 0, 0, 0, 0, 0, 0, 0, 0, 0, 0, 0, 0, 0, 0, 0, 0, 0, 0, 0, 0, 0, 0, 0, 0, 0, 0, 0, 0, 0, 0, 0, 0, 
  0, 0, 0, 0, 0, 0, 0, 0, 0, 0, 0, 0, 0, 0, 0, 0, 0, 0, 0, 0, 0, 0, 0, 0, 0, 0, 0, 0, 0, 0, 0, 0, 0, 0, 0, 0, 
  0, 0, 0, 0, 0, 0, 0, 0, 0, 0, 0, 0, 0, 0, 0, 0, 0, 0, 0, 0, 0, 0, 0, 0, 0, 0, 0, 0, 0, 0, 0, 0, 0, 0, 0, 0, 
  0, 0, 0, 0, 0, 0, 0, 0, 0, 0, 0, 0, 0, 0, 0, 0, 0, 0, 0, 0, 0, 0, 0, 0, 0, 0, 0, 0, 0, 0, 0, 0, 0, 0, 0, 0, 
  0, 0, 0, 0, 0, 0, 0, 0, 0, 0, 0, 0, 0, 0, 0, 0, 0, 0, 0, 0, 0, 0, 0, 0, 0, 0, 0, 0, 0, 0, 0, 0, 0, 0, 0, 0, 
  0, 0, 0, 0, 0, 0, 0, 0, 0, 0, 0, 0, 0, 0, 0, 0, 0, 0, 0, 0, 0, 0, 0, 0, 0, 0, 0, 0, 0, 0, 0, 0, 0, 0, 0, 0, 
  0, 0, 0, 0, 0, 0, 0, 0, 0, 0, 0, 0, 0, 0, 0, 0, 0, 0, 0, 0, 0, 0, 0, 0, 0, 0, 0, 0, 0, 0, 0, 0, 0, 0, 0, 0, 
  0, 0, 0, 0, 0, 0, 0, 0, 0, 0, 0, 0, 0, 0, 0, 0, 0, 0, 0, 0, 0, 0, 0, 0, 0, 0, 0, 0, 0, 0, 0, 0, 0, 0, 0, 0, 
  0, 0, 0, 0, 0, 0, 0, 0, 0, 0, 0, 0, 0, 0, 0, 0, 0, 0, 0, 0, 0, 0, 0, 0, 0, 0, 0, 0, 0, 0, 0, 0, 0, 0, 0, 0, 
  0, 0, 0, 0, 0, 0, 0, 0, 0, 0, 0, 0, 0, 0, 0, 0, 0, 0, 0, 0, 0, 0, 0, 0, 0, 0, 0, 0, 0, 0, 0, 0, 0, 0, 0, 0, 
  0, 0, 0, 0, 0, 0, 0, 0, 0, 0, 0, 0, 0, 0, 0, 0, 0, 0, 0, 0, 0, 0, 0, 0, 0, 0, 0, 0, 0, 0, 0, 0, 0, 0, 0, 0, 
  0, 0, 0, 0, 0, 0, 0, 0, 0, 0, 0, 0, 0, 0, 0, 0, 0, 0, 0, 0, 0, 0, 0, 0, 0, 0, 0, 0, 0, 0, 0, 0, 0, 0, 0, 0, 
  0, 0, 0, 0, 0, 0, 0, 0, 0, 0, 0, 0, 0, 0, 0, 0, 0, 0, 0, 0, 0, 0, 0, 0, 0, 0, 0, 0, 0, 0, 0, 0, 0, 0, 0, 0, 
  0, 0, 0, 0, 0, 0, 0, 0, 0, 0, 0, 0, 0, 0, 0, 0, 0, 0, 0, 0, 0, 0, 0, 0, 0, 0, 0, 0, 0, 0, 0, 0, 0, 0, 0, 0, 
  0, 0, 0, 0, 0, 0, 0, 0, 0, 0, 0, 0, 0, 0, 0, 0, 0, 0, 0, 0, 0, 0, 0, 0, 0, 0, 0, 0, 0, 0, 0, 0, 0, 0, 0, 0, 
  0, 0, 0, 0, 0, 0, 0, 0, 0, 0, 0, 0, 0, 0, 0, 0, 0, 0, 0, 0, 0, 0, 0, 0, 0, 0, 0, 0, 0, 0, 0, 0, 0, 0, 0, 0, 
  0, 0, 0, 0, 0, 0, 0, 0, 0, 0, 0, 0, 0, 0, 0, 0, 0, 0, 0, 0, 0, 0, 0, 0, 0, 0, 0, 0, 0, 0, 0, 0, 0, 0, 0, 0, 
  0, 0, 0, 0, 0, 0, 0, 0, 0, 0, 0, 0, 0, 0, 0, 0, 0, 0, 0, 0, 0, 0, 0, 0, 0, 0, 0, 0, 0, 0, 0, 0, 0, 0, 0, 0, 
  0, 0, 0, 0, 0, 0, 0, 0, 0, 0, 0, 0, 0, 0, 0, 0, 0, 0, 0, 0, 0, 0, 0, 0, 0, 0, 0, 0, 0, 0, 0, 0, 0, 0, 0, 0, 
  0, 0, 0, 0, 0, 0, 0, 0, 0, 0, 0, 0, 0, 0, 0, 0, 0, 0, 0, 0, 0, 0, 0, 0, 0, 0, 0, 0, 0, 0, 0, 0, 0, 0, 0, 0, 
  0, 0, 0, 0, 0, 0, 0, 0, 0, 0, 0, 0, 0, 0, 0, 0, 0, 0, 0, 0, 0, 0, 0, 0, 0, 0, 0, 0, 0, 0, 0, 0, 0, 0, 0, 0, 
  0, 0, 0, 0, 0, 0, 0, 0, 0, 0, 0, 0, 0, 0, 0, 0, 0, 0, 0, 0, 0, 0, 0, 0, 0, 0, 0, 0, 0, 0, 0, 0, 0, 0, 0, 0, 
  0, 0, 0, 0, 0, 0, 0, 0, 0, 0, 0, 0, 0, 0, 0, 0, 0, 0, 0, 0, 0, 0, 0, 0, 0, 0, 0, 0, 0, 0, 0, 0, 0, 0, 0, 0, 
  0, 0, 0, 0, 0, 0, 0, 0, 0, 0, 0, 0, 0, 0, 0, 0, 0, 0, 0, 0, 0, 0, 0, 0, 0, 0, 0, 0, 0, 0, 0, 0, 0, 0, 0, 0, 
  0, 0, 0, 0, 0, 0, 0, 0, 0, 0, 0, 0, 0, 0, 0, 0, 0, 0, 0, 0, 0, 0, 0, 0, 0, 0, 0, 0, 0, 0, 0, 0, 0, 0, 0, 0, 
  0, 0, 0, 0, 0, 0, 0, 0, 0, 0, 0, 0, 0, 0, 0, 0, 0, 0, 0, 0, 0, 0, 0, 0, 0, 0, 0, 0, 0, 0, 0, 0, 0, 0, 0, 0, 
  0, 0, 0, 0, 0, 0, 0, 0, 0, 0, 0, 0, 0, 0, 0, 0, 0, 0, 0, 0, 0, 0, 0, 0, 0, 0, 0, 0, 0, 0, 0, 0 
};
  byte gMetaHasVT[1580] = {
  1, 1, 1, 1, 1, 1, 1, 1, 1, 1, 1, 1, 1, 1, 1, 1, 1, 1, 1, 1, 1, 1, 1, 1, 1, 1, 1, 0, 1, 0, 1, 1, 0, 1, 1, 0, 
  0, 0, 0, 0, 0, 0, 0, 0, 0, 0, 0, 0, 0, 0, 0, 0, 1, 0, 0, 0, 0, 0, 0, 1, 1, 1, 1, 1, 1, 1, 1, 1, 1, 1, 0, 1, 
  1, 1, 0, 1, 1, 1, 1, 1, 0, 1, 1, 1, 1, 1, 1, 1, 1, 1, 1, 1, 1, 1, 1, 1, 1, 1, 1, 1, 1, 1, 1, 1, 1, 1, 1, 1, 
  1, 1, 1, 1, 1, 1, 0, 1, 1, 1, 1, 1, 1, 1, 1, 1, 1, 1, 1, 1, 1, 1, 1, 1, 1, 1, 1, 1, 1, 1, 1, 1, 1, 1, 0, 1, 
  1, 1, 1, 1, 1, 1, 0, 1, 1, 1, 0, 0, 0, 0, 1, 1, 1, 1, 1, 1, 1, 0, 1, 1, 0, 1, 1, 1, 1, 1, 0, 0, 1, 1, 0, 1, 
  0, 1, 1, 1, 1, 1, 1, 0, 1, 1, 1, 1, 0, 0, 1, 0, 1, 0, 1, 1, 1, 1, 1, 1, 1, 0, 1, 1, 1, 1, 1, 1, 1, 1, 0, 1, 
  1, 1, 1, 1, 1, 1, 1, 1, 1, 1, 1, 1, 1, 1, 0, 1, 1, 1, 1, 1, 0, 1, 1, 1, 1, 1, 1, 1, 1, 1, 1, 1, 1, 1, 1, 1, 
  1, 1, 1, 1, 1, 1, 0, 0, 0, 0, 0, 0, 0, 0, 0, 0, 0, 0, 0, 0, 0, 0, 0, 0, 0, 0, 0, 0, 0, 0, 0, 0, 0, 0, 0, 0, 
  0, 0, 0, 0, 0, 0, 0, 0, 0, 0, 0, 0, 0, 0, 0, 0, 0, 0, 0, 0, 0, 0, 0, 0, 0, 0, 0, 0, 0, 0, 0, 0, 0, 0, 0, 0, 
  0, 0, 0, 0, 0, 0, 0, 0, 0, 0, 0, 0, 0, 0, 0, 0, 0, 0, 0, 0, 0, 0, 0, 0, 0, 0, 0, 0, 0, 0, 0, 0, 0, 0, 0, 0, 
  0, 0, 0, 0, 0, 0, 0, 0, 1, 1, 1, 1, 1, 1, 1, 1, 1, 1, 1, 1, 1, 1, 1, 1, 1, 1, 1, 1, 0, 1, 1, 1, 1, 1, 1, 1, 
  1, 1, 1, 1, 1, 1, 1, 1, 1, 1, 1, 1, 1, 1, 1, 1, 0, 0, 0, 0, 0, 0, 0, 0, 0, 0, 0, 0, 0, 0, 0, 0, 0, 0, 0, 0, 
  0, 0, 0, 0, 0, 0, 0, 0, 0, 0, 0, 0, 0, 0, 0, 0, 0, 0, 0, 0, 0, 0, 0, 0, 0, 0, 0, 0, 0, 0, 0, 0, 0, 0, 0, 0, 
  0, 0, 0, 0, 0, 0, 0, 0, 0, 0, 0, 0, 1, 1, 0, 0, 0, 0, 0, 0, 0, 1, 0, 1, 1, 1, 1, 1, 1, 0, 1, 1, 1, 1, 1, 1, 
  1, 1, 1, 1, 1, 1, 1, 1, 1, 0, 0, 0, 0, 1, 1, 0, 1, 1, 1, 0, 1, 1, 1, 0, 0, 0, 1, 0, 0, 1, 1, 1, 1, 1, 0, 1, 
  1, 0, 1, 1, 1, 0, 1, 1, 1, 1, 1, 0, 0, 1, 1, 1, 1, 1, 1, 1, 1, 1, 1, 1, 1, 1, 1, 1, 1, 1, 1, 1, 1, 1, 1, 1, 
  1, 1, 1, 1, 1, 1, 1, 1, 1, 1, 1, 1, 1, 1, 0, 1, 0, 1, 1, 1, 0, 1, 1, 0, 1, 1, 1, 1, 1, 0, 1, 1, 1, 1, 1, 1, 
  1, 1, 1, 1, 1, 1, 1, 1, 1, 1, 1, 1, 1, 1, 1, 1, 1, 1, 1, 1, 1, 1, 1, 1, 1, 1, 1, 1, 1, 1, 1, 1, 1, 1, 1, 1, 
  0, 1, 0, 1, 0, 1, 0, 1, 0, 1, 1, 1, 1, 1, 1, 1, 1, 1, 1, 1, 1, 1, 1, 1, 1, 1, 1, 1, 1, 1, 1, 1, 1, 1, 1, 1, 
  1, 0, 1, 0, 1, 0, 1, 0, 1, 0, 1, 0, 1, 1, 1, 1, 1, 0, 1, 1, 1, 1, 1, 1, 1, 1, 1, 1, 1, 1, 1, 1, 1, 1, 1, 1, 
  1, 1, 1, 1, 1, 1, 1, 1, 1, 1, 1, 1, 1, 1, 0, 0, 0, 0, 0, 0, 0, 0, 0, 0, 0, 0, 0, 0, 0, 0, 0, 0, 1, 1, 1, 1, 
  1, 1, 1, 1, 1, 1, 1, 1, 1, 1, 1, 1, 1, 1, 1, 1, 1, 1, 1, 1, 1, 1, 1, 1, 1, 1, 0, 1, 0, 1, 1, 1, 1, 1, 1, 0, 
  0, 1, 1, 1, 0, 1, 1, 0, 1, 1, 1, 1, 1, 0, 1, 1, 1, 1, 1, 1, 1, 1, 1, 0, 1, 1, 1, 1, 1, 1, 0, 1, 1, 1, 1, 1, 
  1, 1, 1, 1, 1, 1, 1, 1, 1, 1, 1, 1, 1, 0, 1, 1, 1, 1, 1, 1, 1, 1, 1, 1, 1, 1, 1, 1, 1, 1, 1, 1, 1, 1, 1, 1, 
  1, 1, 1, 1, 1, 0, 1, 0, 0, 0, 0, 0, 0, 0, 0, 0, 0, 1, 0, 0, 0, 0, 0, 0, 0, 0, 0, 0, 1, 1, 1, 1, 1, 1, 1, 1, 
  0, 1, 1, 1, 0, 1, 0, 1, 1, 0, 1, 1, 1, 1, 1, 0, 1, 1, 1, 1, 1, 1, 0, 1, 1, 1, 1, 1, 1, 1, 1, 1, 0, 0, 1, 1, 
  1, 1, 1, 1, 1, 1, 0, 0, 0, 0, 0, 0, 0, 0, 1, 1, 1, 1, 1, 1, 1, 1, 1, 1, 1, 1, 1, 1, 1, 0, 0, 0, 0, 0, 0, 0, 
  1, 0, 0, 0, 0, 0, 0, 0, 0, 0, 0, 0, 0, 0, 0, 0, 0, 0, 0, 0, 0, 0, 0, 0, 0, 0, 0, 0, 0, 0, 0, 0, 0, 0, 0, 0, 
  0, 0, 0, 0, 0, 0, 0, 0, 0, 0, 0, 0, 0, 0, 0, 0, 0, 0, 0, 0, 0, 0, 0, 0, 1, 0, 0, 0, 0, 0, 0, 0, 0, 0, 0, 0, 
  0, 0, 0, 0, 0, 0, 0, 0, 0, 0, 0, 0, 0, 0, 0, 0, 0, 0, 0, 0, 0, 0, 0, 0, 0, 0, 0, 0, 0, 0, 0, 0, 0, 0, 0, 0, 
  0, 0, 0, 0, 0, 0, 0, 0, 0, 0, 0, 0, 0, 0, 0, 0, 0, 0, 0, 0, 0, 0, 0, 0, 0, 0, 0, 0, 0, 0, 0, 0, 0, 0, 0, 0, 
  0, 0, 0, 0, 0, 0, 0, 0, 0, 0, 0, 0, 0, 0, 0, 0, 0, 0, 0, 0, 0, 0, 0, 0, 0, 0, 0, 0, 0, 0, 0, 0, 0, 0, 0, 0, 
  0, 0, 0, 1, 0, 0, 0, 0, 0, 0, 0, 0, 0, 0, 0, 0, 0, 0, 0, 0, 0, 0, 0, 0, 0, 0, 0, 0, 0, 0, 0, 0, 0, 1, 0, 0, 
  0, 0, 0, 0, 0, 0, 0, 0, 0, 0, 0, 0, 0, 0, 0, 0, 0, 0, 0, 0, 0, 0, 0, 0, 1, 0, 0, 0, 0, 0, 0, 1, 0, 1, 1, 1, 
  1, 1, 1, 0, 1, 1, 0, 1, 0, 1, 1, 1, 1, 1, 1, 1, 1, 1, 1, 1, 1, 1, 1, 1, 0, 1, 1, 1, 0, 1, 1, 1, 1, 1, 1, 1, 
  1, 1, 1, 1, 1, 0, 1, 1, 1, 1, 1, 0, 1, 0, 1, 1, 0, 0, 1, 1, 1, 0, 1, 1, 0, 0, 1, 1, 0, 0, 1, 1, 0, 0, 1, 1, 
  0, 0, 1, 1, 0, 0, 1, 1, 0, 0, 1, 1, 0, 0, 1, 1, 0, 0, 1, 1, 0, 0, 1, 1, 0, 1, 1, 1, 1, 1, 1, 1, 1, 1, 1, 1, 
  1, 1, 1, 1, 1, 1, 1, 0, 1, 1, 1, 1, 1, 1, 1, 0, 1, 1, 1, 1, 1, 1, 1, 1, 1, 1, 1, 1, 1, 1, 1, 1, 1, 1, 1, 1, 
  1, 1, 1, 1, 1, 1, 1, 1, 1, 1, 1, 1, 1, 1, 1, 1, 1, 1, 1, 1, 1, 1, 1, 1, 1, 1, 1, 1, 1, 1, 1, 1, 1, 1, 1, 1, 
  1, 1, 1, 0, 0, 0, 0, 0, 0, 0, 0, 0, 0, 0, 0, 1, 1, 1, 1, 0, 1, 1, 1, 0, 1, 1, 1, 1, 1, 0, 1, 0, 1, 1, 1, 1, 
  1, 1, 1, 0, 0, 0, 1, 0, 1, 1, 1, 0, 0, 1, 1, 1, 1, 1, 1, 0, 1, 1, 1, 1, 0, 1, 1, 1, 1, 1, 1, 1, 1, 1, 1, 1, 
  1, 1, 1, 1, 0, 1, 1, 0, 1, 1, 1, 0, 0, 1, 1, 1, 0, 0, 0, 0, 0, 0, 0, 1, 1, 0, 0, 0, 1, 1, 1, 1, 1, 1, 1, 1, 
  1, 1, 1, 1, 1, 1, 1, 1, 1, 1, 1, 1, 1, 1, 1, 1, 1, 1, 1, 1, 1, 1, 1, 1, 1, 1, 0, 1, 0, 1, 1, 0, 0, 1, 1, 0, 
  0, 1, 1, 0, 0, 1, 1, 0, 0, 1, 1, 0, 0, 1, 1, 1, 1, 1, 1, 0, 1, 1, 1, 1, 1, 1, 0, 1, 1, 0, 1, 1 
};
  double gMetaFactor[1580] = {
  1, 1, 1, 1, 1, 1, 1, 1, 1, 1, 1, 1, 1, 1, 1, 1, 1, 1, 1, 1, 1, 1, 1, 1, 1, 1, 1, 1, 1, 1, 1, 1, 1, 1, 1, 1, 
  1, 1, 0.1, 0.1, 0.1, 0.1, 0.1, 1, 1, 1, 1, 0.4, 0.4, 0.1, 1, 0.025, 1, 1, 0.025, 0.025, 1, 1, 1, 1, 1, 1, 1, 
  1, 1, 1, 1, 1, 1, 1, 1, 1, 1, 1, 1, 1, 1, 1, 1, 1, 1, 1, 1, 1, 1, 1, 1, 1, 1, 1, 1, 1, 1, 1, 1, 1, 1, 0.1, 
  0.5, 1, 1, 1, 1, 1, 1, 1, 1, 1, 1, 1, 1, 1, 5, 1, 0.019607843, 1, 1, 1, 1, 1, 1, 2, 1, 1, 1, 1, 1, 1, 1, 1, 
  1, 1, 1, 1, 1, 1, 1, 1, 1, 1, 1, 1, 1, 1, 1, 1, 1, 1, 1, 0.019607843, 1, 1, 1, 1, 4, 4, 4, 0.1, 0.55, 3, 1, 
  1, 1, 1, 1, 1, 1, 0.25, 1, 1, 0.0625, 1, 1, 1, 1, 1, 0.4, 1, 1, 1, 1, 1, 2, 2, 1, 1, 1, 1, 1, 1, 1, 1, 1, 1, 
  1, 1, 1, 1, 1, 1, 1, 1, 1, 1, 1, 1, 1, 1, 1, 1, 1, 1, 1, 1, 1, 1, 1, 1, 1, 1, 1, 1, 1, 1, 1, 1, 1, 1, 1, 1, 
  1, 1, 0.02, 1, 0.02, 1, 1, 1, 0.08, 1, 1, 1, 1, 1, 1, 1, 1, 1, 1, 1, 1, 1, 1, 1, 1, 1, 1, 1, 1, 1, 1, 1, 1, 
  1, 1, 1, 1, 1, 1, 1, 1, 1, 1, 1, 1, 1, 1, 1, 1, 1, 1, 1, 1, 1, 1, 1, 1, 1, 1, 1, 1, 1, 1, 1, 1, 1, 1, 1, 1, 
  1, 1, 1, 1, 1, 1, 1, 1, 1, 1, 1, 1, 1, 1, 1, 1, 1, 1, 1, 1, 1, 1, 1, 1, 1, 1, 1, 1, 1, 1, 1, 1, 1, 1, 1, 1, 
  1, 1, 1, 1, 1, 1, 1, 1, 1, 1, 1, 1, 1, 1, 1, 1, 1, 1, 1, 1, 1, 1, 1, 1, 1, 1, 1, 1, 1, 1, 1, 1, 1, 1, 0.5, 
  1, 1, 5, 1, 1, 1, 0.5, 1, 1, 5, 1, 1, 1, 1, 5, 1, 1, 1, 1, 1, 1, 1, 1, 1, 1, 1, 1, 1, 1, 1, 1, 1, 1, 1, 1, 
  1, 1, 1, 1, 1, 1, 1, 1, 1, 1, 1, 1, 1, 1, 1, 1, 1, 1, 1, 1, 1, 1, 1, 1, 1, 1, 1, 1, 1, 1, 1, 1, 1, 1, 1, 1, 
  1, 1, 1, 1, 1, 1, 1, 1, 1, 1, 1, 1, 1, 1, 1, 1, 1, 1, 1, 1, 1, 1, 1, 1, 1, 1, 1, 1, 1, 1, 1, 1, 1, 1, 1, 1, 
  1, 1, 1, 1, 1, 1, 1, 0.019607843, 0.019607843, 0.019607843, 0.019607843, 1, 1, 1, 1, 1, 1, 0.392, 1, 1, 1, 
  1, 1, 1, 0.0625, 1, 1, 1, 1, 1, 1, 1, 1, 1, 1, 1, 1, 1, 1, 1, 25, 1, 0.1, 1, 0.1, 1, 0.392, 1, 1, 1, 0.1, 
  0.1, 0.1, 1, 0.1, 1, 1, 1, 1, 1, 1, 1, 1, 1, 1, 1, 1, 0.195, 1, 1, 0.4, 0.4, 1, 1, 1, 1, 1, 1, 1, 1, 0.0022, 
  1, 1, 1, 1, 1, 1, 1, 1, 1, 1, 1, 1, 1, 1, 1, 1, 1, 1, 1, 1, 1, 1, 1, 1, 1, 1, 1, 1, 1, 1, 1, 1, 0.01, 1, 1, 
  1, 1, 1, 1, 1, 1, 1, 1, 0.1, 1, 1, 1, 1, 1, 1, 1, 1, 0.01, 1, 1, 1, 1, 1, 1, 1, 1, 0.1, 1, 1, 1, 1, 1, 1, 1, 
  1, 1, 1, 1, 1, 1, 1, 1, 1, 1, 0.04, 1, 24, 1, 1, 1, 0.1, 1, 0.2, 0.2, 0.1, 1, 1, 1, 1, 1, 1, 1, 1, 1, 1, 1, 
  1, 1, 1, 1, 1, 1, 1, 1, 1, 1, 1, 1, 1, 1, 1, 0.5, 1, 1, 5, 1, 1, 0.5, 1, 1, 5, 1, 1, 1, 1, 1, 1, 1, 0.3922, 
  1, 1, 1, 0.3922, 1, 1, 1, 1, 1, 2, 1, 1, 1, 0.1, 1, 1, 1, 5, 1, 1, 1, 1, 5, 1, 1, 5, 1, 1, 1, 5, 1, 5, 1, 1, 
  5, 1, 1, 1, 5, 1, 4, 4, 1, 1, 1, 1, 1, 1, 1, 1, 1, 1, 1, 1, 1, 1, 1, 1, 1, 1, 1, 0.5, 1, 1, 5, 1, 1, 1, 0.5, 
  1, 1, 5, 1, 1, 1, 1, 1, 5, 1, 1, 5, 1, 1, 1, 1, 5, 1, 1, 5, 1, 1, 0.1, 1, 1, 1, 0.5, 1, 1, 0.01, 1, 1, 1, 1, 
  4, 1, 1.5625, 4, 1, 0.1, 0.1, 1, 1, 3, 1, 1, 1, 1, 1, 1, 1, 1, 1, 1, 1, 1, 1, 1, 1, 1, 1, 1, 1, 1, 1, 1, 1, 
  1, 1, 1, 1, 1, 1, 1, 1, 1, 1, 1, 1, 1, 1, 0.1, 1, 0.4, 0.05, 1, 1, 1, 0.02, 0.1, 0.1, 1, 0.05, 0.025, 1, 1, 
  1, 1, 1, 1, 2, 1, 1, 1, 0.125, 0.125, 1, 2, 1, 1, 1, 1, 1, 1, 1, 1, 1, 1, 1, 1, 1, 1, 1, 1, 1, 1, 1, 1, 1, 
  1, 1, 1, 1, 1, 1, 1, 1, 1, 1, 1, 1, 1, 1, 1, 1, 1, 1, 1, 1, 1, 0.25, 1, 1, 1, 1, 1, 3.6, 1, 50, 1, 1, 
  0.3922, 1, 1, 1, 1, 1, 1, 1, 1, 1, 0.3922, 1, 1, 1, 1, 0.1, 0.1, 0.1, 0.1, 0.1, 0.01, 0.1, 1, 1, 1, 1, 1, 1, 
  1, 1, 1, 1, 1, 1, 1, 1, 1, 1, 1, 1, 1, 1, 1, 1, 1, 1, 1, 1, 1, 1, 1, 1, 1, 1, 1, 1, 1, 1, 1, 1, 1, 1, 1, 1, 
  1, 1, 1, 1, 1, 1, 1, 1, 1, 1, 1, 1, 1, 1, 1, 1, 1, 1, 1, 1, 1, 1, 1, 1, 1, 1, 1, 1, 1, 1, 1, 1, 1, 1, 1, 1, 
  1, 1, 1, 1, 1, 1, 1, 1, 1, 1, 1, 1, 1, 1, 1, 1, 1, 1, 1, 1, 1, 1, 1, 1, 1, 1, 1, 1, 1, 1, 1, 1, 1, 1, 1, 1, 
  1, 1, 1, 1, 1, 1, 1, 1, 1, 1, 1, 1, 1, 1, 1, 1, 1, 1, 1, 1, 1, 1, 1, 1, 1, 1, 1, 1, 1, 1, 1, 1, 1, 1, 1, 1, 
  1, 1, 1, 1, 1, 1, 1, 1, 1, 1, 1, 1, 1, 1, 1, 1, 1, 1, 1, 1, 1, 1, 1, 1, 1, 1, 1, 1, 1, 1, 1, 1, 1, 1, 1, 1, 
  1, 1, 1, 1, 1, 1, 1, 1, 1, 1, 1, 1, 1, 1, 1, 1, 1, 1, 1, 1, 1, 1, 1, 1, 1, 1, 1, 1, 1, 1, 1, 1, 1, 1, 1, 1, 
  1, 1, 1, 1, 1, 1, 1, 1, 1, 1, 1, 1, 1, 0.1, 0.1, 1, 1, 1, 1, 1, 1, 1, 1, 1, 1, 1, 1, 1, 1, 1, 1, 1, 1, 1, 1, 
  1, 1, 1, 1, 1, 1, 1, 1, 1, 0.1, 0.1, 1, 0.1, 0.01, 0.1, 1, 1, 0.1, 1, 1, 0.02, 1, 0.02, 1, 0.02, 1, 1, 1, 1, 
  1, 1, 1, 1, 1, 1, 1, 1, 1, 1, 1, 1, 1, 1, 1, 1, 1, 1, 1, 1, 1, 1, 1, 1, 1, 1, 1, 1, 1, 1, 1, 1, 1, 1, 1, 1, 
  1, 1, 1, 1, 1, 1, 1, 1, 1, 1, 1, 1, 1, 1, 1, 1, 1, 1, 1, 1, 1, 1, 1, 1, 1, 1, 1, 1, 1, 1, 1, 1, 1, 1, 1, 1, 
  1, 1, 1, 1, 1, 1, 1, 1, 1, 1, 1, 1, 1, 1, 1, 1, 1, 1, 1, 1, 1, 1, 1, 1, 1, 1, 1, 1, 4, 1, 1, 1, 1, 1, 1, 1, 
  1, 1, 1, 1, 1, 1, 1, 1, 1, 1, 1, 1, 1, 1, 1, 1, 1, 1, 1, 1, 1, 1, 1, 1, 1, 0.1, 0.1, 0.1, 0.1, 1, 1, 1, 1, 
  1, 0.1, 0.1, 1, 1, 1, 1, 1, 1, 1, 1, 1, 1, 1, 1, 1, 1, 1, 1, 1, 1, 1, 1, 5, 1, 1, 5, 1, 1, 1, 1, 5, 1, 1, 5, 
  1, 1, 1, 1, 1, 1, 1, 1, 1, 1, 1, 1, 1, 2, 2, 1, 1, 1, 1, 1, 1, 1, 1, 1, 1, 1, 1, 1, 1, 1, 1, 3, 1, 1, 1, 1, 
  1, 1, 1, 10, 1, 1, 2.05, 1, 1, 1, 0.125, 1, 1, 4, 1, 1, 1, 1, 1, 1, 1, 1, 1, 1, 1, 1, 1, 1, 1, 1, 1, 1, 1, 
  1, 1, 1, 1, 1, 1, 1, 1, 1, 1, 1, 1, 1, 1, 1, 1, 1, 1, 1, 1, 1, 1, 1, 1, 1, 1, 1, 1, 1, 1, 1, 1, 1, 1, 1, 1, 
  1, 1, 1, 1, 1, 1, 1, 1, 1, 1, 1, 1, 1, 1, 1, 1, 1, 1, 1, 1, 1, 1, 1, 1, 1, 1, 1, 1, 1, 1, 1, 1, 1, 1, 1, 1, 
  1, 1, 1, 1, 1, 1, 1, 1, 1, 1, 1, 1, 1, 1, 1, 1, 1, 1, 1, 1, 1, 1, 1, 1, 1, 1, 1, 1, 0.0625, 0.0625, 1, 
  0.0625, 0.0625 
};
  double gMetaOffset[1580] = {
  0, 0, 0, 0, 0, 0, 0, 0, 0, 0, 0, 0, 0, 0, 0, 0, 0, 0, 0, 0, 0, 0, 0, 0, 0, 0, 0, 0, 0, 0, 0, 0, 0, 0, 0, 0, 
  0, 0, 0, 0, 0, 0, 0, -40, -40, -40, 0, 0, 0, -250, -30, 4, 0, 0, 10.6, 10.6, 0, 0, 0, 0, 0, 0, 0, 0, 0, 0, 
  0, 0, 0, 0, 0, 0, 0, 0, 0, 0, 0, 0, 0, 0, 0, 0, 0, 0, 0, 0, 0, 0, 0, 0, 0, 0, 0, 0, 0, 0, 0, -40, -85, 0, 0, 
  0, 0, 0, 0, 0, 0, 0, 0, 0, 0, 0, 40, 0, 0, 0, 0, 0, 0, 0, 0, 0, 0, 0, 0, 0, 0, 0, 0, 0, 0, 0, 0, 0, 0, 0, 0, 
  0, 0, 0, 0, 0, 0, 0, 0, 0, 0, 0, 0, 0, 0, 0, 0, 0, 0, 0, 0, 0, -119.7, 0, 0, 0, 0, 0, 0, 0, 0, 0, 0, 0, 0, 
  0, 0, 0, 0, 0, 0, 0, 0, 0, 0, 0, 0, 0, 0, 0, 0, -7767, 0, 0, 0, 0, 0, 0, 0, 0, 0, 0, 0, 0, 0, 0, 0, 0, 0, 0, 
  0, 0, 0, 0, 0, 0, 0, 0, 0, 0, 0, 0, 0, 0, 0, 0, 0, 0, 0, 0, 0, 0, 0, 0, 0, 0, -40.96, 0, -40.96, 0, 0, -100, 
  -163.84, 0, 0, 0, 0, 0, 0, 0, 0, 0, 0, 0, 0, 0, 0, 0, 0, 0, 0, 0, 0, 0, 0, 0, 0, 0, 0, 0, 0, 0, 0, 0, 0, 0, 
  0, 0, 0, 0, 0, 0, 0, 0, 0, 0, 0, 0, 0, 0, 0, 0, 0, 0, 0, 0, 0, 0, 0, 0, 0, 0, 0, 0, 0, 0, 0, 0, 0, 0, 0, 0, 
  0, 0, 0, 0, 0, 0, 0, 0, 0, 0, 0, 0, 0, 0, 0, 0, 0, 0, 0, 0, 0, 0, 0, 0, 0, 0, 0, 0, 0, 0, 0, 0, 0, 0, 0, 0, 
  0, 0, 0, 0, 0, 0, 0, 0, 0, 0, 0, 0, 0, 0, 0, 0, 0, 0, 0, 0, 0, 0, 0, 0, 0, 16, 0, 0, 0, 0, 0, 0, 16, 0, 0, 
  0, 0, 0, 0, 0, 800, 0, 0, 0, 0, 0, 0, 0, 0, 0, 0, 0, 0, 0, 0, 0, 0, 0, 0, 0, 0, 0, 0, 0, 0, 0, 0, 0, 0, 0, 
  0, 0, 0, 0, 0, 0, 0, 0, 0, 0, 0, 0, 0, 0, 0, 0, 0, 0, 0, 0, 0, 0, 0, 0, 0, 0, 0, 0, 0, 0, 0, 0, 0, 0, 0, 0, 
  0, 0, 0, 0, 0, 0, 0, 0, 0, 0, 0, 0, 0, 0, 0, 0, 0, 0, 0, 0, 0, 0, 0, 0, 0, 0, 0, 0, 0, 0, 0, 0, 0, 0, 0, 0, 
  0, 0, 0, 0, 0, 0, 0, 0, 0, 0, 0, 0, 0, 0, 0, 0, 0, 0, 0, 0, 0, 0, 0, 0, 0, 0, 0, 0, 0, 0, 0, 0, 0, 0, 0, 0, 
  0, 0, 0, 0, 0, 0, 0, 0, 0, 0, 0, -500, 0, 0, 0, -500, 0, -500, 0, 0, 0, -500, -25, 0, 0, 0, 0, 0, 0, 0, 0, 
  0, 0, -40, 0, 0, 0, 0, 0, 0, 0, 0, 0, 0, 0, 0, 0, 0, 0, 0, 0, 0, 0, 0, 0, 0, 0, 0, 0, 0, 0, 0, 0, 0, 0, 0, 
  0, 0, 0, 0, 0, 0, 0, 0, 0, 0, 0, 0, 0, -720, 0, 0, -2000, 0, 0, 0, 0, 0, 0, 0, 0, 0, 0, 0, 0, 0, 0, 0, 0, 0, 
  0, 0, 0, 0, 0, 0, 0, 0, 0, 0, -40, 0, 0, 0, 0, 0, 0, 0, 0, 0, 0, 0, 0, 50, 50, 100, -1024, 0, -1024, 0, 
  -512, 0, -100, 0, -100, 0, 0, 0, 0, 0, 0, 0, 0, 0, 0, 0, 0, 0, 0, 0, 0, 0, 16, 0, 0, 0, 0, 0, 16, 0, 0, 0, 
  0, -125, 0, 0, 0, 0, 0, 0, 0, -125, 0, 0, 0, 0, 0, 0, 0, 0, 0, 0, 0, 0, 0, 0, 0, 0, 0, 0, 0, 0, 0, 0, 0, 0, 
  0, 0, 0, 0, 0, 0, 0, 0, 0, 0, 0, 0, 0, 0, -7767, -7767, 0, 0, 0, 0, 0, 0, 0, 0, 0, 0, 0, 0, 0, 0, 0, 0, 0, 
  0, 0, 16, 0, 0, 0, 0, 0, 0, 16, 0, 0, 0, 0, 0, 0, 0, 0, 0, 0, 0, 0, 0, 0, 0, 0, 0, 0, 0, 0, 0, 0, 0, 0, 0, 
  0, -20, -40, 0, -40, 0, 0, 0, 0, -7767, 0, -4604.688, -7768, 0, -50, 0, 0, 0, 0, -32768, 0, 0, 0, 0, 0, 0, 
  0, 0, 0, 0, 0, 0, 0, 0, 0, 0, 0, 0, 0, 0, 0, 0, 0, 0, 0, 0, 0, 0, 0, 0, 0, 0, 0, 0, 0, 0, 0, 0, 0, 0, 0, 0, 
  0, -1000, 0, 0, 0, 5, 5, 0, 0, 0, 0, 0, 0, 0, 0, -40, 0, 0, 0, 0, 0, 0, 0, 0, 0, 0, 0, 0, 0, 0, 0, 0, 0, 0, 
  0, 0, 0, 0, 0, 0, 0, 0, 0, 0, 0, 0, 0, 0, 0, -500, -500, -500, 0, 0, 0, 0, 0, 0, 0, -500, 0, 0, 0, -500, 0, 
  0, 0, 0, 0, 300, 0, 0, 0, 0, 0, 0, 0, 0, 0, 0, 0, 0, 0, 0, 0, -40, 0, 0, 0, -2000, 0, 0, 0, 0, 0, 0, 0, 0, 
  0, 0, 0, 0, 0, 0, 0, 0, 0, 0, 0, 0, 0, 0, 0, 0, 0, 0, 0, 0, 0, 0, 0, 0, 0, 0, 0, 0, 0, 0, 0, 0, 0, 0, 0, 0, 
  0, 0, 0, 0, 0, 0, 0, 0, 0, 0, 0, 0, 0, 0, 0, 0, 0, 0, 0, 0, 0, 0, 0, 0, 0, 0, 0, 0, 0, 0, 0, 0, 0, 0, 0, 0, 
  0, 0, 0, 0, 0, 0, 0, 0, 0, 0, 0, 0, 0, 0, 0, 0, 0, 0, 0, 0, 0, 0, 0, 0, 0, 0, 0, 0, 0, 0, 0, 0, 0, 0, 0, 0, 
  0, 0, 0, 0, 0, 0, 0, 0, 0, 0, 0, 0, 0, 0, 0, 0, 0, 0, 0, 0, 0, 0, 0, 0, 0, 0, 0, 0, 0, 0, 0, 0, 0, 0, 0, 0, 
  0, 0, 0, 0, 0, 0, 0, 0, 0, 0, 0, 0, 0, 0, 0, 0, 0, 0, 0, 0, 0, 0, 0, 0, 0, 0, 0, 0, 0, 0, 0, 0, 0, 0, 0, 0, 
  0, 0, 0, 0, 0, 0, 0, 0, 0, 0, 0, 0, 0, 0, 0, 0, 0, 0, 0, 0, 0, 0, 0, 0, 0, 0, 0, 0, 0, 0, 0, 0, 0, 0, 0, 0, 
  0, 0, 0, 0, 0, 0, 0, 0, 0, 0, 0, 0, 0, 0, 0, 0, 0, 0, 0, 0, 0, 0, 0, 0, 0, 0, 0, 0, 0, 0, 0, 0, 0, 0, 0, 0, 
  0, 0, 0, 0, 0, 0, 0, 0, 0, 0, 0, 0, 0, 0, 0, 0, 0, 0, 0, 0, 0, 0, 0, -40.96, 0, -40.96, 0, -40.96, 0, 0, 0, 
  0, 0, 0, 0, 0, 0, 0, 0, 0, 0, 0, 0, 0, 0, 0, 0, 0, 0, 0, 0, 0, 0, 0, 0, 0, 0, 0, 0, 0, 0, 0, 0, 0, 0, 0, 0, 
  0, 0, 0, 0, 0, 0, 0, 0, 0, 0, 0, 0, 0, 0, 0, 0, 0, 0, 0, 0, 0, 0, 0, 0, 0, 0, 0, 0, 0, 0, 0, 0, 0, 0, 0, 0, 
  0, 0, 0, 0, 0, 0, 0, 0, 0, 0, 0, 0, 0, 0, 0, 0, 0, 0, 0, 0, 0, 0, 0, 0, 0, 0, 0, 0, 0, 0, 0, 0, 0, 0, 0, 0, 
  0, 0, 0, 0, 0, 0, 0, 0, 0, 0, 0, 0, 0, 0, 0, 0, 0, 0, 0, 0, 0, 0, 0, 0, 0, 0, 0.7, 0.7, 0.7, 0.7, 0, 0, 0, 
  0, 0, 0.7, 0.7, 0, 0, 0, 0, 0, 0, 0, 0, 0, 0, 0, 0, 0, 0, 0, 0, 0, 0, 0, 0, 0, 0, 0, 0, 0, 0, 0, 0, 0, 0, 0, 
  0, 0, 0, 0, 0, 0, 0, 0, 0, 0, 0, 0, 0, 0, 0, 0, 0, 0, 0, -500, -500, -500, 0, 0, 0, 0, 0, 0, 0, 0, 0, 0, 
  -40, 0, 0, 0, 0, 0, 0, 0, 0, -500, 0, 0, 0, 0, 0, 0, 0, 0, 500, 0, 0, 0, 0, 0, 0, 0, 0, 0, 0, 0, 0, 0, 0, 0, 
  0, 0, 0, 0, 0, 0, 0, 0, 0, 0, 0, 0, 0, 0, 0, 0, 0, 0, 0, 0, 0, 0, 0, 0, 0, 0, 0, 0, 0, 0, 0, 0, 0, 0, 0, 0, 
  0, 0, 0, 0, 0, 0, 0, 0, 0, 0, 0, 0, 0, 0, 0, 0, 0, 0, 0, 0, 0, 0, 0, 0, 0, 0, 0, 0, 0, 0, 0, 0, 0, 0, 0, 0, 
  0, 0, 0, 0, 0, 0, 0, 0, 0, 0, 0, 0, 0, 0, 0, 0, 0, 0, 0, 0, 0, 0, 0, 0, 0, 0, 0, 0, 0, 0, 0, 0, 0, 0, 0, 0, 
  0 
};
  double gMetaMin[1580] = {
  0, 0, 0, 0, 0, 0, 0, 0, 0, 0, 0, 0, 0, 0, 0, 0, 0, 0, 0, 0, 0, 0, 0, 0, 0, 0, 0, 0, 0, 0, 0, 0, 0, 0, 0, 0, 
  0, 0, 0, 0, 0, 0, 0, -40, -40, -40, 0, 0, 0, -250, -30, 4, 0, 0, 10.6, 10.6, 0, 0, 0, 0, 0, 0, 0, 0, 0, 0, 
  0, 0, 0, 0, 0, 0, 0, 0, 0, 0, 0, 0, 0, 0, 0, 0, 0, 0, 0, 0, 0, 0, 0, 0, 0, 0, 0, 0, 0, 0, 0, -40, -85, 0, 0, 
  0, 0, 0, 0, 0, 0, 0, 0, 0, 0, 0, 40, 0, 0, 0, 0, 0, 0, 0, 0, 0, 0, 0, 0, 0, 0, 0, 0, 0, 0, 0, 0, 0, 0, 0, 0, 
  0, 0, 0, 0, 0, 0, 0, 0, 0, 0, 0, 0, 0, 0, 0, 0, 0, 0, 0, 0, 0, -119.7, 0, 0, 0, 0, 0, 0, 0, 0, 0, 0, 0, 0, 
  0, 0, 0, 0, 0, 0, 0, 0, 0, 0, 0, 0, 0, 0, 0, 0, -7767, 0, 0, 0, 0, 0, 0, 0, 0, 0, 0, 0, 0, 0, 0, 0, 0, 0, 0, 
  0, 0, 0, 0, 0, 0, 0, 0, 0, 0, 0, 0, 0, 0, 0, 0, 0, 0, 0, 0, 0, 0, 0, 0, 0, 0, -40.96, 0, -40.96, 0, 0, -100, 
  -163.84, 0, 0, 0, 0, 0, 0, 0, 0, 0, 0, 0, 0, 0, 0, 0, 0, 0, 0, 0, 0, 0, 0, 0, 0, 0, 0, 0, 0, 0, 0, 0, 0, 0, 
  0, 0, 0, 0, 0, 0, 0, 0, 0, 0, 0, 0, 0, 0, 0, 0, 0, 0, 0, 0, 0, 0, 0, 0, 0, 0, 0, 0, 0, 0, 0, 0, 0, 0, 0, 0, 
  0, 0, 0, 0, 0, 0, 0, 0, 0, 0, 0, 0, 0, 0, 0, 0, 0, 0, 0, 0, 0, 0, 0, 0, 0, 0, 0, 0, 0, 0, 0, 0, 0, 0, 0, 0, 
  0, 0, 0, 0, 0, 0, 0, 0, 0, 0, 0, 0, 0, 0, 0, 0, 0, 0, 0, 0, 0, 0, 0, 0, 0, 16, 0, 0, 0, 0, 0, 0, 16, 0, 0, 
  0, 0, 0, 0, 0, 0, 0, 0, 0, 0, 0, 0, 0, 0, 0, 0, 0, 0, 0, 0, 0, 0, 0, 0, 0, 0, 0, 0, 0, 0, 0, 0, 0, 0, 0, 0, 
  0, 0, 0, 0, 0, 0, 0, 0, 0, 0, 0, 0, 0, 0, 0, 0, 0, 0, 0, 0, 0, 0, 0, 0, 0, 0, 0, 0, 0, 0, 0, 0, 0, 0, 0, 0, 
  0, 0, 0, 0, 0, 0, 0, 0, 0, 0, 0, 0, 0, 0, 0, 0, 0, 0, 0, 0, 0, 0, 0, 0, 0, 0, 0, 0, 0, 0, 0, 0, 0, 0, 0, 0, 
  0, 0, 0, 0, 0, 0, 0, 0, 0, 0, 0, 0, 0, 0, 0, 0, 0, 0, 0, 0, 0, 0, 0, 0, 0, 0, 0, 0, 0, 0, 0, 0, 0, 0, 0, 0, 
  0, 0, 0, 0, 0, 0, 0, 0, 0, 0, -500, 0, 0, 0, -500, 0, -500, 0, 0, 0, -500, -25, 0, 0, 0, 0, 0, 0, 0, 0, 0, 
  0, -40, 0, 0, 0, 0, 0, 0, 0, 0, 0, 0, 0, 0, 0, 0, 0, 0, 0, 0, 0, 0, 0, 0, 0, 0, 0, 0, 0, 0, 0, 0, 0, 0, 0, 
  0, 0, 0, 0, 0, 0, 0, 0, 0, 0, 0, 0, -720, 0, 0, -2000, 0, 1, 0, 0, 1, 0, 0, 0, 0, 0, 0, 0, 0, 0, 0, 0, 0, 0, 
  0, 0, 0, 0, 0, 0, 0, 0, 0, -40, 0, 0, 0, 0, 0, 0, 0, 0, 0, 0, 0, 0, 50, 50, 100, -1024, 0, -1024, 0, -512, 
  0, -100, 0, -100, 0, 0, 0, 0, 0, 0, 0, 0, 0, 0, 0, 0, 0, 0, 0, 0, 0, 16, 0, 0, 0, 0, 0, 16, 0, 0, 0, 0, 
  -125, 0, 0, 0, 0, 0, 0, 0, -125, 0, 0, 0, 0, 0, 0, 0, 0, 0, 0, 0, 0, 0, 0, 0, 0, 0, 0, 0, 0, 0, 0, 0, 0, 0, 
  0, 0, 0, 0, 0, 0, 0, 0, 0, 0, 0, 0, 0, -7767, -7767, 0, 0, 0, 0, 0, 0, 0, 0, 0, 0, 0, 0, 0, 0, 0, 0, 0, 0, 
  0, 16, 0, 0, 0, 0, 0, 0, 16, 0, 0, 0, 0, 0, 0, 0, 0, 0, 0, 0, 0, 0, 0, 0, 0, 0, 0, 0, 0, 0, 0, 0, 0, 0, 0, 
  -20, -40, 0, -40, 0, 0, 0, 0, -7767, 0, -4604.688, -7768, 0, -50, 0, 0, 0, 0, -32768, 0, 0, 0, 0, 0, 0, 0, 
  0, 0, 0, 0, 0, 0, 0, 0, 0, 0, 0, 0, 0, 0, 0, 0, 0, 0, 0, 0, 0, 0, 0, 0, 0, 0, 0, 0, 0, 0, 0, 0, 0, 0, 0, 0, 
  -1000, 0, 0, 0, 5, 5, 0, 0, 0, 0, 0, 0, 0, 0, -40, 0, 0, 0, 0, 0, 0, 0, 0, 0, 0, 0, 0, 0, 0, 0, 0, 0, 0, 0, 
  0, 0, 0, 0, 0, 0, 0, 0, 0, 0, 0, 0, 0, 0, -500, -500, -500, 0, 0, 0, 0, 0, 0, 0, -500, 0, 0, 0, -500, 0, 0, 
  0, 0, 0, 300, 0, 0, 0, 0, 0, 0, 0, 0, 0, 0, 0, 0, 0, 0, 0, -40, 0, 0, 0, -2000, 0, 0, 0, 0, 0, 0, 0, 0, 0, 
  0, 0, 0, 0, 0, 0, 0, 0, 0, 0, 0, 0, 0, 0, 0, 0, 0, 0, 0, 0, 0, 0, 0, 0, 0, 0, 0, 0, 0, 0, 0, 0, 0, 0, 0, 0, 
  0, 0, 0, 0, 0, 0, 0, 0, 0, 0, 0, 0, 0, 0, 0, 0, 0, 0, 0, 0, 0, 0, 0, 0, 0, 0, 0, 0, 0, 0, 0, 0, 0, 0, 0, 0, 
  0, 0, 0, 0, 0, 0, 0, 0, 0, 0, 0, 0, 0, 0, 0, 0, 0, 0, 0, 0, 0, 0, 0, 0, 0, 0, 0, 0, 0, 0, 0, 0, 0, 0, 0, 0, 
  0, 0, 0, 0, 0, 0, 0, 0, 0, 0, 0, 0, 0, 0, 0, 0, 0, 0, 0, 0, 0, 0, 0, 0, 0, 0, 0, 0, 0, 0, 0, 0, 0, 0, 0, 0, 
  0, 0, 0, 0, 0, 0, 0, 0, 0, 0, 0, 0, 0, 0, 0, 0, 0, 0, 0, 0, 0, 0, 0, 0, 0, 0, 0, 0, 0, 0, 0, 0, 0, 0, 0, 0, 
  0, 0, 0, 0, 0, 0, 0, 0, 0, 0, 0, 0, 0, 0, 0, 0, 0, 0, 0, 0, 0, 0, 0, 0, 0, 0, 0, 0, 0, 0, 0, 0, 0, 0, 0, 0, 
  0, 0, 0, 0, 0, 0, 0, 0, 0, 0, 0, 0, 0, 0, 0, 0, 0, 0, 0, 0, 0, 0, 0, 0, 0, 0, 0, 0, 0, 0, 0, 0, 0, 0, 0, 0, 
  0, 0, 0, 0, 0, 0, 0, 0, 0, 0, 0, 0, 0, 0, 0, 0, 0, 0, 0, 0, 0, 0, -40.96, 0, -40.96, 0, -40.96, 0, 0, 0, 0, 
  0, 0, 0, 0, 0, 0, 0, 0, 0, 0, 0, 0, 0, 0, 0, 0, 0, 0, 0, 0, 0, 0, 0, 0, 0, 0, 0, 0, 0, 0, 0, 0, 0, 0, 0, 0, 
  0, 0, 0, 0, 0, 0, 0, 0, 0, 0, 0, 0, 0, 0, 0, 0, 0, 0, 0, 0, 0, 0, 0, 0, 0, 0, 0, 0, 0, 0, 0, 0, 0, 0, 0, 0, 
  0, 0, 0, 0, 0, 0, 0, 0, 0, 0, 0, 0, 0, 0, 0, 0, 0, 0, 0, 0, 0, 0, 0, 0, 0, 0, 0, 0, 0, 0, 0, 0, 0, 0, 0, 0, 
  0, 0, 0, 0, 0, 0, 0, 0, 0, 0, 0, 0, 0, 0, 0, 0, 0, 0, 0, 0, 0, 0, 0, 0, 0, 0.7, 0.7, 0.7, 0.7, 0, 0, 0, 0, 
  0, 0.7, 0.7, 0, 0, 0, 0, 0, 0, 0, 0, 0, 0, 0, 0, 0, 0, 0, 0, 0, 0, 0, 0, 0, 0, 0, 0, 0, 0, 0, 0, 0, 0, 0, 0, 
  0, 0, 0, 0, 0, 0, 0, 0, 0, 0, 0, 0, 0, 0, 0, 0, 0, 0, -500, -500, -500, 0, 0, 0, 0, 0, 0, 0, 0, 0, 0, -40, 
  0, 0, 0, 0, 0, 0, 0, 0, -500, 0, 0, 0, 0, 0, 0, 0, 0, 500, 0, 0, 0, 0, 0, 0, 0, 0, 0, 0, 0, 0, 0, 0, 0, 0, 
  0, 0, 0, 0, 0, 0, 0, 0, 0, 0, 0, 0, 0, 0, 0, 0, 0, 0, 0, 0, 0, 0, 0, 0, 0, 0, 0, 0, 0, 0, 0, 0, 0, 0, 0, 0, 
  0, 0, 0, 0, 0, 0, 0, 0, 0, 0, 0, 0, 0, 0, 0, 0, 0, 0, 0, 0, 0, 0, 0, 0, 0, 0, 0, 0, 0, 0, 0, 0, 0, 0, 0, 0, 
  0, 0, 0, 0, 0, 0, 0, 0, 0, 0, 0, 0, 0, 0, 0, 0, 0, 0, 0, 0, 0, 0, 0, 0, 0, 0, 0, 0, 0, 0, 0, 0, 0, 0, 0, 0 
};
  double gMetaMax[1580] = {
  3, 2, 2, 1, 2, 6, 1, 2, 2, 2, 1, 2, 6, 1, 2, 1, 2, 1, 2, 1, 2, 1, 2, 1, 2, 1, 2, 255, 6, 15, 3, 3, 255, 1, 
  3, 15, 0, 4294967295, 429496729.5, 429496729.5, 429496729.5, 429496729.5, 429496729.5, 215, 215, 215, 65535, 
  102, 102, 159.5, 97, 16.775, 1, 127, 16.975, 16.975, 255, 4294967295, 65535, 1, 1, 1, 1, 1, 1, 1, 1, 1, 3, 
  7, 255, 1, 1, 2, 15, 15, 3, 1, 1, 3, 65535, 1, 5, 3, 3, 1, 1, 7, 1, 7, 1023, 1023, 3, 7, 31, 1, 1, 85, 170, 
  1, 1, 2, 1, 2, 1, 1, 1, 1, 3, 1, 1, 1, 110, 7, 4.999999965, 1, 5, 255, 1, 15, 1, 508, 1, 1, 1, 1, 1, 1, 1, 
  3, 1, 30, 1, 1, 62, 1, 1, 1, 1, 7, 6, 15, 255, 14, 3, 15, 3, 31, 1, 4.98, 15, 15, 3, 0, 262140, 262140, 
  262140, 429496729.5, 20.55, 12282, 15, 1, 3, 1, 2, 255, 1, 255.5, 15, 1, 511.875, 1, 2, 2, 255, 15, 102, 3, 
  255, 1, 15, 2, 124, 124, 7, 2, 2, 24999, 1, 1, 1, 7, 255, 15, 1, 255, 1, 15, 1, 255, 1, 1, 1, 3, 1, 255, 1, 
  1, 1, 1, 1, 1, 1, 1, 15, 1, 1, 1, 3, 3, 3, 3, 1, 1, 1, 1, 1, 1, 3, 3, 255, 1, 40.92, 1, 40.92, 1, 15, 154, 
  163.68, 1, 3, 1, 1, 1, 255, 255, 1, 1, 7, 1, 1, 1, 1, 3, 255, 63, 63, 1, 15, 15, 15, 15, 15, 15, 15, 15, 15, 
  15, 15, 15, 15, 15, 15, 15, 15, 15, 15, 15, 15, 15, 15, 15, 15, 15, 15, 15, 15, 15, 15, 15, 15, 15, 15, 15, 
  15, 15, 15, 15, 15, 15, 15, 15, 15, 15, 15, 15, 15, 15, 15, 15, 15, 15, 15, 15, 15, 15, 15, 15, 15, 15, 15, 
  15, 15, 15, 15, 15, 15, 15, 15, 15, 15, 15, 15, 15, 15, 15, 15, 15, 15, 15, 15, 15, 15, 15, 15, 15, 15, 15, 
  15, 15, 15, 15, 15, 15, 15, 15, 15, 15, 15, 15, 15, 15, 15, 15, 15, 15, 15, 15, 2, 31, 254, 30, 70, 1, 1, 2, 
  31, 254, 30, 70, 1, 1, 3, 1, 3350, 1, 6, 1, 1048575, 3, 1, 3, 3, 3, 7, 1, 1, 3, 3, 1, 1, 255, 1, 1, 3, 1, 1, 
  1, 1, 1, 3, 3, 0, 0, 0, 0, 0, 0, 0, 0, 0, 0, 0, 0, 0, 0, 0, 0, 0, 0, 0, 0, 0, 0, 0, 0, 0, 0, 0, 0, 0, 0, 0, 
  0, 0, 0, 0, 0, 0, 0, 0, 0, 0, 0, 0, 0, 0, 0, 0, 0, 0, 0, 0, 0, 0, 0, 0, 0, 0, 0, 0, 0, 0, 0, 0, 0, 0, 0, 0, 
  0, 1, 1, 1, 1, 4.98, 4.98, 4.98, 4.98, 0, 1, 255, 16382, 1, 3, 99.568, 1, 1, 15, 3, 1, 3, 511.875, 255, 1, 
  1, 1, 1, 7, 31, 1, 1, 127, 4095, 4095, 31, 255, 15, 6375, 1, 429496729.5, 8190, 40, 1, 99.96, 7, 1, 1, 
  819.1, 819.1, 819.1, 1, 6553.5, 255, 1546, 1, 1, 1, 1546, 15, 1546, 1, 255, 510, 1546, 24.53, 15, 1, 100, 
  102, 1, 1, 255, 15, 1, 1, 215, 1, 144.1748, 3, 15, 15, 1, 6, 14, 1, 1, 15, 3, 31, 15, 1, 1, 15, 14, 15, 15, 
  1, 1, 3, 15, 1, 1, 1, 1, 1, 1, 1, 1, 1, 1, 2.55, 1, 255, 1, 1, 1, 15, 3, 7, 255, 1, 720, 1, 3, 2094, 15, 31, 
  23, 59, 12, 59.99, 65534, 3, 1, 3, 3, 1, 3, 1, 40, 7, 6, 7, 14, 14, 14, 6, 1, 15, 1, 8190, 2046, 214, 6, 1, 
  1, 1, 10.16, 1, 6096, 1, 1, 1, 200, 1, 100, 100, 919.1, 1023, 1, 1023, 1, 1535, 1, 100, 1, 100, 1, 1, 1, 1, 
  1, 1, 1, 1, 1, 1, 1, 1, 1, 1, 1, 1, 2, 31, 254, 30, 70, 1, 2, 31, 254, 30, 70, 1, 130, 1, 1023, 1, 127, 1, 
  100, 1, 130, 1, 100, 2046, 2046, 510, 510, 1, 2046, 255, 1, 1, 102.3, 1, 1, 23, 55, 126, 1, 255, 23, 55, 1, 
  23, 55, 1, 255, 23, 55, 30, 55, 15, 23, 55, 15, 15, 23, 55, 255, 24993, 24993, 15, 0, 0, 0, 0, 0, 0, 0, 0, 
  0, 0, 0, 0, 0, 0, 0, 0, 0, 2, 31, 254, 30, 70, 1, 1, 2, 31, 254, 30, 70, 1, 1, 1, 1, 23, 55, 255, 23, 55, 1, 
  1, 1, 23, 55, 255, 23, 55, 1, 100, 6553.5, 0, 1, 100, 107, 214, 100, 85, 255, 15, 1, 1, 24997, 255, 
  20993.7495, 24992, 15, 50, 300, 62, 14, 3066, 32767, 1, 1, 255, 255, 255, 255, 255, 255, 255, 255, 255, 255, 
  255, 255, 255, 255, 255, 1, 1, 1, 1, 1, 1, 1, 1, 1, 1, 1, 1, 1, 1, 1, 1, 1, 1, 15, 6553.5, 65535, 102, 
  3276.75, 1, 1, 1, 310.7, 25.5, 25.5, 1, 11.35, 17.775, 1, 1, 127, 1, 255, 1, 254, 1, 215, 1, 8191, 8191, 
  4094, 131068, 0, 255, 0, 0, 0, 0, 0, 0, 0, 0, 0, 0, 255, 0, 0, 0, 0, 0, 0, 0, 0, 0, 255, 1, 3, 1, 1, 1, 
  1546, 1546, 1546, 15, 7, 1, 15, 255, 4094, 15, 1546, 15, 255, 1, 1547.5, 1, 15, 15, 15, 1, 1214.4, 1, 10000, 
  1, 250, 100, 1, 1, 1, 1022, 1, 1, 1, 1, 1, 100, 215, 7, 7, 7, 4553.5, 1638.3, 102.3, 102.3, 102.3, 
  42949672.95, 429496729.5, 65535, 255, 255, 255, 255, 255, 255, 255, 255, 255, 255, 255, 255, 255, 255, 255, 
  255, 255, 255, 255, 255, 65535, 4294967295, 255, 255, 255, 255, 255, 0, 255, 255, 255, 255, 255, 31, 31, 31, 
  31, 31, 65535, 65535, 65535, 65535, 65535, 65535, 65535, 7, 7, 7, 7, 7, 255, 255, 255, 255, 255, 255, 255, 
  255, 255, 255, 65535, 65535, 65535, 65535, 65535, 65535, 65535, 65535, 65535, 65535, 65535, 65535, 65535, 
  65535, 65535, 4294967295, 65535, 65535, 65535, 65535, 65535, 65535, 65535, 65535, 65535, 65535, 4294967295, 
  0, 4294967295, 4294967295, 4294967295, 4294967295, 4294967295, 255, 255, 255, 255, 255, 255, 255, 255, 255, 
  255, 255, 255, 255, 255, 255, 255, 255, 255, 255, 255, 255, 255, 255, 255, 255, 255, 255, 255, 255, 255, 
  255, 255, 255, 255, 255, 255, 255, 255, 255, 255, 4294967295, 4294967295, 4294967295, 4294967295, 
  4294967295, 4294967295, 4294967295, 4294967295, 4294967295, 255, 4294967295, 4294967295, 4294967295, 
  4294967295, 4294967295, 4294967295, 4294967295, 4294967295, 4294967295, 4294967295, 4294967295, 4294967295, 
  4294967295, 4294967295, 4294967295, 4294967295, 4294967295, 4294967295, 4294967295, 4294967295, 4294967295, 
  4294967295, 4294967295, 4294967295, 4294967295, 4294967295, 4294967295, 4294967295, 4294967295, 4294967295, 
  4294967295, 4294967295, 4294967295, 4294967295, 4294967295, 4294967295, 4294967295, 4294967295, 4294967295, 
  4294967295, 255, 255, 255, 255, 255, 255, 255, 255, 255, 255, 65535, 4294967295, 4294967295, 4294967295, 
  4294967295, 4294967295, 4294967295, 255, 255, 255, 255, 255, 255, 255, 255, 4294967295, 65535, 0, 
  4294967295, 4294967295, 255, 255, 255, 255, 255, 65535, 65535, 65535, 65535, 65535, 255, 255, 4294967295, 
  4294967295, 65535, 65535, 65535, 65535, 65535, 4294967295, 4294967295, 429496729.5, 429496729.5, 255, 255, 
  255, 255, 0, 0, 0, 0, 0, 0, 0, 0, 0, 0, 0, 0, 0, 0, 0, 0, 0, 0, 0, 0, 0, 0, 0, 0, 0, 819.1, 6553.5, 1, 
  6553.5, 655.35, 6553.5, 8191, 4294967295, 429496729.5, 1, 1048575, 40.92, 1, 40.92, 1, 40.94, 1, 255, 2, 1, 
  255, 6, 15, 14, 254, 14, 15, 2, 2, 3, 3, 3, 3, 1, 1, 254, 14, 3, 255, 5, 3, 1, 15, 1, 1, 1, 1, 7, 1, 1, 7, 
  1, 1, 1, 1, 255, 1, 1, 1, 1, 1, 15, 1, 1, 1, 1, 255, 255, 1, 1, 1, 1, 2, 1, 1, 1, 2, 1, 1, 1, 2, 1, 1, 1, 2, 
  1, 1, 1, 2, 1, 1, 1, 2, 1, 1, 1, 2, 1, 1, 1, 2, 1, 1, 1, 2, 1, 1, 1, 2, 1, 1, 7, 3, 65534, 1, 1, 3, 7, 1, 3, 
  1020, 1, 1, 1, 1, 3, 1, 1, 1, 255, 31, 1, 1, 1, 14, 3, 1, 15, 3, 1, 1, 15, 15, 7, 7, 15, 7, 1, 4, 4, 4, 4, 
  2, 7, 7, 7, 7, 1, 1, 1, 4, 4, 7, 7, 1, 1, 1, 1, 3, 15, 15, 63, 63, 1, 1, 3, 3, 3, 1, 0, 0, 1, 1, 23, 55, 
  255, 23, 55, 1, 1, 1, 23, 55, 255, 23, 55, 1, 9, 9, 9, 9, 9, 9, 9, 9, 9, 9, 9, 9, 32766, 32766, 3, 3, 255, 
  1546, 1546, 1546, 15, 1, 3, 1, 1, 2, 255, 3, 15, 65534, 149, 1, 1, 1, 1, 65534, 255, 15, 10230, 522, 255, 
  8392.7, 1, 1, 15, 23.125, 3, 15, 1516, 7, 3, 1, 255, 15, 1, 15, 1, 15, 1, 1, 1, 1, 1, 1, 15, 1, 1, 1, 15, 1, 
  63, 1, 3, 255, 1, 1, 15, 1, 1, 3, 255, 65535, 1, 1, 15, 255, 255, 255, 255, 255, 255, 255, 15, 15, 1023, 63, 
  72057594037927904, 3, 1, 1, 1, 1, 1, 1, 1, 1, 1, 1, 1, 1, 1, 1, 1, 1, 1, 1, 1, 1, 1, 1, 1, 1, 1, 1, 1, 1, 1, 
  1, 1, 1, 1, 255, 127, 255, 1, 127, 255, 255, 1, 127, 255, 255, 1, 127, 255, 255, 1, 127, 255, 255, 1, 127, 
  255, 255, 255, 3, 1, 255, 3, 1, 15, 255, 3, 1, 255, 3, 1, 255, 511.875, 511.875, 15, 511.875, 511.875 
};
}
