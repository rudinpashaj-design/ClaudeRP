/*@@author(-)*/
/*@@version(1.0)*/

/* ============================================================================
   CAN GATEWAY BIDIREZIONALE  CAN1 <-> CAN2  (CANalyzer 18)
   + MODIFICA DEL SEGNALE "TotalOdometer" SUL FRAME CLUSTER1 (0x259)
   ============================================================================

   DBC di riferimento:
     P250MY26_C1CANCAN_R1_E1A_CR20190.dbc

   COSA FA
   -------
   Fa da "ponte" (gateway) che ribalta TUTTI i frame circolanti tra i due
   canali:

     - CAN1 -> CAN2 : tutto cio' che arriva su CAN1 (i frame del solo nodo
                      ECM) viene ritrasmesso su CAN2;
     - CAN2 -> CAN1 : tutto cio' che arriva su CAN2 (i frame di tutti gli
                      altri nodi) viene ritrasmesso su CAN1.

   L'inoltro e' "passthrough" completo: viene ribaltato QUALSIASI ID, anche
   quelli non presenti nel DBC. La direzione e' decisa automaticamente in
   base al canale di ricezione (this.can), quindi non serve nessun filtro
   per nodo: dato che ECM trasmette solo su CAN1 e gli altri nodi solo su
   CAN2, l'inoltro simmetrico realizza gia' esattamente lo scenario richiesto.

   ECCEZIONE - FRAME CLUSTER1 (0x259)
   ----------------------------------
   Il frame CLUSTER1 (ID 0x259 = 601 dec) porta il segnale TotalOdometer
   (23|20@0+, big-endian/Motorola, 20 bit, unita' km, range 0..1048575).
   Prima di essere ritrasmesso, il valore di TotalOdometer viene modificato
   secondo la modalita' scelta (vedi gOdoMode piu' sotto). La modifica
   avviene qualunque sia il canale su cui il frame viene ricevuto: si aggancia
   all'ID, non al canale, quindi funziona sia che 0x259 arrivi da CAN2 (come
   da DBC, dove CLUSTER1 e' trasmesso dal nodo IPC) sia che nel tuo banco
   arrivi dal lato ECM/CAN1.

   La riscrittura del segnale usa l'accesso SIMBOLICO (message CLUSTER1 +
   .TotalOdometer): cosi' il packing Motorola a 20 bit e' gestito
   automaticamente dal database, senza manipolare i byte a mano.

   COME MODIFICARE IL VALORE DI TotalOdometer
   ------------------------------------------
   Tre modalita', selezionabili con la variabile gOdoMode (default = 1):
     gOdoMode = 0  -> PASSTHROUGH: il frame passa senza modifiche.
     gOdoMode = 1  -> OVERRIDE:    forza TotalOdometer = gOdoValue (km).
     gOdoMode = 2  -> OFFSET:      TotalOdometer = valore_ricevuto + gOdoOffset
                                   (gOdoOffset e' con segno, in km).

   INSERIMENTO DEL VALORE DI OVERRIDE DALLA WRITE WINDOW
   ----------------------------------------------------
   In CANalyzer un handler "on key" riceve un tasto alla volta, quindi il
   valore si DIGITA cifra per cifra e poi si conferma:
     - premi le cifre 0..9: si compongono nel valore di override, che viene
       via via mostrato nella Write Window;
     - premi INVIO (oppure il tasto 'a' = applica) per applicare il valore
       digitato: viene messo in gOdoValue e la modalita' passa a OVERRIDE;
     - premi 'c' per cancellare cio' che stai digitando (riparte da 0).
   Esempio: per forzare 123456 km premi  1 2 3 4 5 6  poi INVIO.
   (Il valore di default gOdoValue qui sotto resta comunque modificabile a
   compile-time.)

   SETUP IN CANALYZER 18
   ---------------------
   1) Assegna questo DBC ai DUE canali (CAN Network 1 e CAN Network 2) nella
      Networks/Databases della Measurement Setup, oppure ai due canali fisici
      che usi come CAN1/CAN2.
   2) Inserisci questo nodo CAPL nella Measurement Setup e collegalo a
      ENTRAMBI i canali (deve poter ricevere e trasmettere su CAN1 e CAN2).
   3) Se i canali fisici NON sono i numeri 1 e 2, aggiorna kChanCAN1/kChanCAN2
      qui sotto in modo che corrispondano alla Channel Mapping reale.
   ============================================================================ */

variables
{
  /* -------- Numeri di canale ------------------------------------------------
     Cambiali se nella Channel Mapping i canali fisici usati come CAN1/CAN2
     non sono 1 e 2. L'inoltro e' comunque simmetrico (opposto del canale di
     ricezione), quindi la sola cosa che conta e' che questi due valori
     corrispondano ai due canali collegati al nodo CAPL. */
  const dword kChanCAN1 = 1;   /* lato ECM        */
  const dword kChanCAN2 = 2;   /* lato altri nodi */

  /* -------- Frame speciale: CLUSTER1 --------------------------------------- */
  const dword kIdCluster1 = 0x259;   /* 601 dec */
  const dword kOdoMax     = 1048575; /* 20 bit -> valore massimo del segnale  */

  /* -------- Modalita' di modifica di TotalOdometer -------------------------
     0 = passthrough, 1 = override (forza gOdoValue), 2 = offset (+gOdoOffset). */
  int   gOdoMode   = 1;
  dword gOdoValue  = 100000;   /* km da forzare in modalita' OVERRIDE          */
  long  gOdoOffset = 0;        /* km (con segno) da sommare in modalita' OFFSET */

  /* Valore in fase di digitazione dalla Write Window (cifra per cifra),
     applicato a gOdoValue quando si preme INVIO / 'a'. */
  dword gOdoInput  = 0;

  /* -------- Anti-eco / anti-loop ------------------------------------------
     Il frame appena ritrasmesso da questo stesso programma genera un evento
     TX che rientra in "on message *": lo scartiamo con this.dir != RX e con
     questo guard di rientranza, evitando il loop di inoltro A->B->A->... */
  dword gInForward = 0;

  /* Messaggio generico riusato per l'inoltro passthrough (ID impostato a
     runtime: la dichiarazione con 0x000 crea un messaggio scrivibile). */
  message 0x000 gTxMsg;
}


on start
{
  write("=====================================================================");
  write(" Gateway CAN1<->CAN2 attivo. Ribalto tutti i frame tra i due canali.");
  write(" Frame CLUSTER1 (0x259): modifica TotalOdometer.");
  write(" Override: digita le cifre 0..9 e premi INVIO (o 'a') per applicare.");
  LogOdoMode();
  write("=====================================================================");
}


/* ============================================================================
   GATEWAY  +  MODIFICA TotalOdometer SU CLUSTER1 (0x259)
   ============================================================================ */
on message *
{
  int           i;
  dword         targetChannel;
  message CLUSTER1 clu;   /* usato solo per il frame 0x259 (accesso simbolico) */
  dword         newVal;
  long          tmp;

  /* Inoltra solo i frame realmente RICEVUTI dal bus, non quelli che
     trasmettiamo noi (altrimenti si crea un loop). */
  if (this.dir != RX)
  {
    return;
  }
  if (gInForward == 1)
  {
    return;
  }

  /* Direzione: sempre il canale opposto a quello di ricezione. */
  if (this.can == kChanCAN1)
  {
    targetChannel = kChanCAN2;
  }
  else if (this.can == kChanCAN2)
  {
    targetChannel = kChanCAN1;
  }
  else
  {
    return;   /* frame su un canale che non fa parte del gateway */
  }

  /* ---- CASO SPECIALE: CLUSTER1 (0x259) -----------------------------------
     Modifica TotalOdometer con accesso simbolico prima di ritrasmettere.
     Si aggancia all'ID, quindi vale in entrambe le direzioni. */
  if (this.id == kIdCluster1)
  {
    clu = this;                 /* copia id/dlc/dati del frame ricevuto */
    clu.can = targetChannel;
    clu.dir = TX;

    if (gOdoMode == 1)
    {
      /* OVERRIDE: forza il valore configurato (con clamp a 20 bit). */
      newVal = gOdoValue;
      if (newVal > kOdoMax) newVal = kOdoMax;
      clu.TotalOdometer = newVal;
    }
    else if (gOdoMode == 2)
    {
      /* OFFSET: somma (con segno) al valore ricevuto, con clamp 0..max. */
      tmp = (long) clu.TotalOdometer + gOdoOffset;
      if (tmp < 0)              tmp = 0;
      if (tmp > (long) kOdoMax) tmp = kOdoMax;
      clu.TotalOdometer = tmp;
    }
    /* gOdoMode == 0: passthrough, nessuna modifica */

    gInForward = 1;
    output(clu);
    gInForward = 0;
    return;
  }

  /* ---- INOLTRO GENERICO (passthrough) di tutti gli altri frame ------------ */
  gTxMsg.id  = this.id;
  gTxMsg.dlc = this.dlc;
  gTxMsg.dir = TX;
  gTxMsg.can = targetChannel;

  for (i = 0; i < this.dlc && i < 8; i = i + 1)
  {
    gTxMsg.byte(i) = this.byte(i);
  }

  gInForward = 1;
  output(gTxMsg);
  gInForward = 0;
}


/* ============================================================================
   CONTROLLO A RUNTIME DEL VALORE TotalOdometer (Write Window)
   ============================================================================
   NOTA: i tasti "on key" funzionano solo quando la finestra della
   misurazione (o la Write Window) ha il FOCUS. Se un tasto non risponde,
   clicca prima sulla finestra della misurazione e riprova.

   Tasti:
     0..9  : DIGITA il valore di override (mostrato nella Write Window)
     INVIO : applica il valore digitato -> gOdoValue, modalita' OVERRIDE
     a     : come INVIO (applica il valore digitato)
     c     : cancella il valore che stai digitando (riparte da 0)
     p     : modalita' PASSTHROUGH (nessuna modifica su 0x259)
     + / - : modalita' OFFSET, +/-1000 km sull'offset
     r     : azzera valore di override, offset e digitazione
   ============================================================================ */

/* Le cifre 0..9 compongono il valore di override digitato. */
on key '0' { OdoInputDigit(0); }
on key '1' { OdoInputDigit(1); }
on key '2' { OdoInputDigit(2); }
on key '3' { OdoInputDigit(3); }
on key '4' { OdoInputDigit(4); }
on key '5' { OdoInputDigit(5); }
on key '6' { OdoInputDigit(6); }
on key '7' { OdoInputDigit(7); }
on key '8' { OdoInputDigit(8); }
on key '9' { OdoInputDigit(9); }

/* Applica il valore digitato: INVIO (0x0D) oppure 'a'. */
on key 0x0D { OdoInputApply(); }
on key 'a'  { OdoInputApply(); }

/* Cancella la digitazione in corso. */
on key 'c'
{
  gOdoInput = 0;
  write("[Odometer] digitazione azzerata (override in corso = 0 km)");
}

/* PASSTHROUGH: nessuna modifica sul frame 0x259. */
on key 'p'
{
  gOdoMode = 0;
  LogOdoMode();
}

/* OFFSET: +/-1000 km, passa automaticamente in modalita' OFFSET. */
on key '+'
{
  gOdoMode = 2;
  gOdoOffset = gOdoOffset + 1000;
  LogOdoMode();
}

on key '-'
{
  gOdoMode = 2;
  gOdoOffset = gOdoOffset - 1000;
  LogOdoMode();
}

/* Reset completo. */
on key 'r'
{
  gOdoValue  = 0;
  gOdoOffset = 0;
  gOdoInput  = 0;
  LogOdoMode();
}


/* Aggiunge una cifra al valore di override in fase di digitazione. */
void OdoInputDigit(dword d)
{
  gOdoInput = gOdoInput * 10 + d;
  if (gOdoInput > kOdoMax)
  {
    gOdoInput = kOdoMax;   /* clamp a 20 bit (max 1048575 km) */
  }
  write("[Odometer] override digitato = %d km  (INVIO o 'a' per applicare, 'c' per cancellare)", gOdoInput);
}

/* Applica il valore digitato al segnale di override e attiva la modalita'. */
void OdoInputApply()
{
  gOdoValue = gOdoInput;
  if (gOdoValue > kOdoMax)
  {
    gOdoValue = kOdoMax;
  }
  gOdoMode  = 1;    /* OVERRIDE */
  gOdoInput = 0;    /* pronto per una nuova digitazione */
  write("[Odometer] OVERRIDE applicato: TotalOdometer forzato = %d km", gOdoValue);
}


void LogOdoMode()
{
  if (gOdoMode == 0)
  {
    write("[Odometer] modalita' = PASSTHROUGH (nessuna modifica su 0x259)");
  }
  else if (gOdoMode == 1)
  {
    write("[Odometer] modalita' = OVERRIDE, TotalOdometer forzato = %d km", gOdoValue);
  }
  else
  {
    write("[Odometer] modalita' = OFFSET, delta = %d km", gOdoOffset);
  }
}
